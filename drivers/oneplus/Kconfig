## drivers/oneplus/Kconfig
```kconfig
config OEM_BOOT_MODE
	bool "detect oem boot mode"
	default y
	help
          detect oem boot mode  If unsure, say y.

config OEM_TRACE_SUPPORT
	default y
	depends on OEM_DEBUG_SUPPORT
	bool "OEM debug function, enable it will register the device, which under /dev/otracer."


config WB_KERNEL_LOG
	tristate "reserve kernel log to partition driver"
	default n

source "drivers/oneplus/coretech/Kconfig"
```

## drivers/oneplus/coretech/Kconfig
```kconfig
config OPCHAIN
	default n
	bool "Oneplus CoreTech helper, used for opchain module"

config DEFRAG_HELPER
	default n
	bool "Oneplus CoreTech helper, used for defrag module"

config CRPL_HELPER
	default n
	bool "Oneplus CoreTech helper, used for crpl module"

config ADJ_CHAIN
	default n
	bool "Chain task adj for victim select"
	help
	 To chain task adj for any purpose

config HOUSTON
	default n
	bool "houston rocket play your temperature guard"
	help
	 Realtime temperature monitor

config MEMPLUS
	default n
	bool "memory+ feature"
	help
	 Memory+ feature
config FSC
	default n
	bool "system layer file status cache"
	help
	 To cache absence file and avoid stat call storm
```

## drivers/oneplus/coretech/defrag/Kconfig
```kconfig
config DEFRAG
	default y
	bool "Oneplus CoreTech helper, used for defrag module"
```

## drivers/power/Kconfig
```kconfig
source "drivers/power/avs/Kconfig"
source "drivers/power/reset/Kconfig"
source "drivers/power/supply/Kconfig"


#ifdef VENDOR_EDIT

config OPLUS_SM8150Q_CHARGER
	tristate "OPLUS SM8150 charger driver"
	depends on MFD_SPMI_PMIC
	help
	  Enables support for the oplus charging framework
	  
config OPLUS_WPC_INTERFACE_ENABLE
	tristate "OPLUS WPC INTERFACE ENABLE"
	default n
	depends on MFD_SPMI_PMIC
	help
	  Say Y to include support

config OPLUS_SM7150R_CHARGER
	tristate "OPLUS SM7125R charger driver"
	depends on MFD_SPMI_PMIC
	help
	  Enables support for the OPLUS charging framework

config OPLUS_SM7125R_CHARGER
	tristate "OPLUS SM7125R charger driver"
	depends on MFD_SPMI_PMIC
	help
	  Enables support for the OPLUS charging framework

config OPLUS_SM8150R_CHARGER
	tristate "OPLUS SM8150 charger driver"
	depends on MFD_SPMI_PMIC
	help
	  Enables support for the oplus charging framework
	  
config OPLUS_SHORT_C_BATT_CHECK
	tristate "OPLUS_SHORT_C_BATT CHECK SUPPORT"
	default n
	depends on MFD_SPMI_PMIC
	help
	  Say Y to include support

config OPLUS_CALL_MODE_SUPPORT
	bool "OPLUS call mode support"
	help
	  Say Y to include support

config OPLUS_SMART_CHARGER_SUPPORT
	bool "OPLUS smart charger support"
	help
	  Say Y to include support

config OPLUS_SHORT_HW_CHECK
	tristate "OPLUS_SHORT_HW CHECK SUPPORT"
	default n
	depends on MFD_SPMI_PMIC
	help
	  Say Y to include support

config OPLUS_CHIP_SOC_NODE
	bool "OPLUS chip soc node"
	help
	  Say Y to include support

config OPLUS_SHORT_IC_CHECK
	tristate "OPLUS_SHORT_IC CHECK SUPPORT"
	default n
	depends on MFD_SPMI_PMIC
	help
	  Say Y to include support

config OPLUS_RTC_DET_SUPPORT
	tristate "OPLUS RTC DET SUPPORT"
	default n
	depends on MFD_SPMI_PMIC
	help
	  Say Y to include support

config OPLUS_CHECK_CHARGERID_VOLT
	tristate "OPLUS CHECK CHARGERID VOLT"
	default n
	depends on MFD_SPMI_PMIC
	help
	  Say Y to include support

config OPLUS_SHIP_MODE_SUPPORT
	tristate "OPLUS_SHIP_MODE_SUPPORT"
	default n
	depends on MFD_SPMI_PMIC
	help
	  Say Y to include support

config OPLUS_SHORT_USERSPACE
	bool "OPLUS batt userspace"
	help
	  Say Y to include support

config OPLUS_SMOOTH_SOC
	bool "OPLUS SMOOTH SOC "
	help
	  Say Y to include support
source "drivers/power/oplus/Kconfig"
#endif
```

## drivers/power/oplus/Kconfig
```kconfig
menuconfig OPLUS_CHARGER
	bool "OPLUS charging system"
	depends on I2C
	select REGMAP_I2C
	help
	  Say Y here to enable OPLUS charging system support

if OPLUS_CHARGER
config OPLUS_CHARGER_MTK
	bool "OPLUS charger on MTK"
	help
	  Say Y here to declare charging system is on MTK
	  
config OPLUS_SHORT_C_BATT_CHECK
	bool "OPLUS batt short "
	help
	  Say Y here to declare OPLUS batt short	  

config OPLUS_STANDARD_BATTERY_CHECK_ADC
	bool "OPLUS Official Standard Battery check by ADC"
	help
	  Say Y here to support Official Standard Battery check by ADC

config OPLUS_SHORT_IC_CHECK
	bool "OPLUS short ic"
	help
	  Say Y here to declare OPLUS batt short

config OPLUS_SHORT_HW_CHECK
	bool "OPLUS batt HW SHORT "
	help
	  Say Y here to declare charging system is on MTK

config OPLUS_SHORT_USERSPACE
	bool "OPLUS batt userspace"
	help
	  Say Y to include support

config OPLUS_CHIP_SOC_NODE
	bool "OPLUS chip soc node"
	help
	  Say Y to include support

config OPLUS_CHARGER_OPTIGA
	bool "OPLUS OPTIGA soc node"
	help
	  Say Y to include support
endif #OPLUS_CHARGER
```

## drivers/soc/Kconfig
```kconfig
menu "SOC (System On Chip) specific Drivers"

source "drivers/soc/actions/Kconfig"
source "drivers/soc/amlogic/Kconfig"
source "drivers/soc/atmel/Kconfig"
source "drivers/soc/bcm/Kconfig"
source "drivers/soc/fsl/Kconfig"
source "drivers/soc/imx/Kconfig"
source "drivers/soc/mediatek/Kconfig"
source "drivers/soc/qcom/Kconfig"
source "drivers/soc/renesas/Kconfig"
source "drivers/soc/rockchip/Kconfig"
source "drivers/soc/samsung/Kconfig"
source "drivers/soc/sunxi/Kconfig"
source "drivers/soc/tegra/Kconfig"
source "drivers/soc/ti/Kconfig"
source "drivers/soc/ux500/Kconfig"
source "drivers/soc/versatile/Kconfig"
source "drivers/soc/zte/Kconfig"
source "drivers/soc/oplus/Kconfig"
#ifdef OPLUS_FEATURE_IOMONITOR
source "drivers/soc/oplus/iomonitor/Kconfig"
#endif /*OPLUS_FEATURE_IOMONITOR*/
#ifdef VENDOR_EDIT
source "drivers/soc/oplus/Kconfig"
#endif

#ifdef OPLUS_FEATURE_POWERINFO_STANDBY
source "drivers/soc/oplus/owakelock/Kconfig"
#endif /* OPLUS_FEATURE_POWERINFO_STANDBY */
#ifdef VENDOR_EDIT
source "drivers/soc/oplus/oplus_healthinfo/Kconfig"
#endif

#ifdef OPLUS_FEATURE_SENSOR_SMEM
source "drivers/soc/oplus/sensor/Kconfig"
#endif /* OPLUS_FEATURE_SENSOR_SMEM */

#Add for NandSwap
source "drivers/soc/oplus/oplus_nandswap/Kconfig"

#ifdef OPLUS_FEATURE_THERMAL_HORAE
source "drivers/soc/oplus/thermal/Kconfig"
#endif /* OPLUS_FEATURE_THERMAL_HORAE */

#ifdef OPLUS_FEATURE_CPUFREQ_BOUNCING
source "drivers/soc/oplus/rt_info/Kconfig"
#endif

endmenu
```

## drivers/soc/oplus/Kconfig
```kconfig
config OPLUS_ARCH_FILE
  bool "for build directory oplus"
  ---help---
  say Y to buid in

config OPLUS_COMMON_SOFT
  bool "config oplus common software"
  select OPLUS_ARCH_FILE
  help
  define this config to get project verion from sharemem.
  Maybe this value is from CDT or dynamic identify by hardware
  id.

config OPLUS_DEVICE_IFNO
  bool "config oplus devinfo"
  select OPLUS_ARCH_FILE
  help
	define this config to compile devinfo.c for device register

source "drivers/soc/oplus/project_info/Kconfig"
source "drivers/soc/oplus/device_info/Kconfig"

#ifdef OPLUS_ARCH_EXTENDS
source "drivers/soc/oplus/oplus_kevent_feedback/Kconfig"
#endif /* OPLUS_ARCH_EXTENDS */

source "drivers/soc/oplus/system/Kconfig"
#endif /* VENDOR_EDIT */

#ifdef OPLUS_FEATURE_LOWMEM_DBG
source "drivers/soc/oplus/lowmem_dbg/Kconfig"
##endif /* OPLUS_FEATURE_LOWMEM_DBG */

#ifdef OPLUS_FEATURE_MEMLEAK_DETECT
#Add for svelte
source "drivers/soc/oplus/svelte/Kconfig"
#endif /* OPLUS_FEATURE_MEMLEAK_DETECT */
```

## drivers/soc/oplus/device_info/Kconfig
```kconfig
config OPLUS_DEVICE_IFNO
  bool "config oplus devinfo software"
  help
    define this config to compile devinfo.c for device register
```

## drivers/soc/oplus/oplus_kevent_feedback/Kconfig
```kconfig
#ifdef OPLUS_ARCH_EXTENDS
config OPLUS_CRITICALLOG
bool "config oplus kevent feedback"
help
    define this config to init oplus kevent feedback driver.
#endif /* OPLUS_ARCH_EXTENDS */
```

## drivers/soc/oplus/project_info/Kconfig
```kconfig
config OPLUS_COMMON_SOFT
  bool "config oplus common software"
  help
	define this config to get project verion from sharemem.
	Maybe this value is from CDT or dynamic identify by hardware
	id.
```

## drivers/soc/oplus/rt_info/Kconfig
```kconfig
config OPLUS_FEATURE_RT_INFO
	tristate "rt info stat"
	default m
	help
		Schedule info statistics for render thread
```

## kernel/Kconfig.iolimit
```kconfig
config CGROUP_IOLIMIT
	bool "limit controller whitch use to turn the io-limit feature on"
	default n
	help
	  This feature lets vfs recognize task groups and
	  control IO bandwidth allocation to such task
	  groups. It uses cgroups to group tasks. This
	  is a limit controller whitch use to turn the
	  io-limit feature on.

config PANIC_FLUSH
	bool "flush blk device in panic flow"
	default y
	help
	  add flush behaviour in panic flow also contains
	  the blk_issue_flush statistics information
	  /proc/sysctl/blkdev_issue_flush_count.
```

## net/oplus_connectivity_sla/Kconfig
```kconfig
# SPDX-License-Identifier: GPL-2.0-only
# Copyright (C) 2020-2022 Oplus. All rights reserved.

config OPLUS_FEATURE_WIFI_SLA
	tristate "Add for oplus sla function"
	help
	  Add for oplus sla function.
```

## net/oplus_score/Kconfig
```kconfig
# SPDX-License-Identifier: GPL-2.0-only
# Copyright (C) 2020-2022 Oplus. All rights reserved.

config OPLUS_FEATURE_DATA_EVAL
        tristate "Add for network score"
        help
          Add for Add for network score.
```

## net/oplus_wificapcenter/Kconfig
```kconfig
# SPDX-License-Identifier: GPL-2.0-only
# Copyright (C) 2020-2022 Oplus. All rights reserved.

config OPLUS_FEATURE_WIFI_CAPCENTER
	bool "Add for Oplus Wifi capability center"
	help
	  Add for Oplus Wifi capability center.

config OPLUS_FEATURE_WIFI_OPLUSWFD
	bool "Add for OplusWFD"
	help
	  Add for Add for OplusWFD.
```
