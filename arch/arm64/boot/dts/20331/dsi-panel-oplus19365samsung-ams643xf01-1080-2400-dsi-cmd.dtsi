&mdss_mdp {
	dsi_oplus19365samsung_ams643xf01_1080_2400_cmd: qcom,mdss_dsi_oplus19365samsung_ams643xf01_1080_2400_cmd {
		qcom,mdss-dsi-panel-name =
		  "samsung ams643xf01 amoled fhd+ panel without DSC";
		qcom,mdss-dsi-panel-type = "dsi_cmd_mode";
		qcom,mdss-dsi-virtual-channel-id = <0>;
		qcom,mdss-dsi-stream = <0>;
		qcom,mdss-dsi-bpp = <24>;
		qcom,mdss-dsi-color-order = "rgb_swap_rgb";
		qcom,mdss-dsi-underflow-color = <0xff>;
		qcom,mdss-dsi-border-color = <0>;

		qcom,dsi-ctrl-num = <0>;
		qcom,dsi-phy-num = <0>;
		qcom,dsi-select-clocks = "src_byte_clk0", "src_pixel_clk0";

		qcom,mdss-dsi-traffic-mode = "non_burst_sync_event";
		qcom,mdss-dsi-lane-map = "lane_map_0123";
		qcom,mdss-dsi-bllp-eof-power-mode;
		qcom,mdss-dsi-bllp-power-mode;
		qcom,mdss-dsi-lane-0-state;
		qcom,mdss-dsi-lane-1-state;
		qcom,mdss-dsi-lane-2-state;
		qcom,mdss-dsi-lane-3-state;
		qcom,mdss-dsi-dma-trigger = "trigger_sw";
		qcom,mdss-dsi-mdp-trigger = "none";
		qcom,mdss-dsi-reset-sequence = <1 10>, <0 10>, <1 10>;
		qcom,mdss-dsi-te-pin-select = <1>;
		qcom,mdss-dsi-te-dcs-command = <1>;
		qcom,mdss-dsi-te-check-enable;
		qcom,mdss-dsi-te-using-te-pin;
		qcom,mdss-dsi-wr-mem-start = <0x2c>;
		qcom,mdss-dsi-wr-mem-continue = <0x3c>;
		qcom,mdss-dsi-panel-hdr-enabled;
		qcom,mdss-dsi-panel-hdr-color-primaries = <15000 15500 34000
			16000 13250 34500 7500 3000>;
		qcom,mdss-dsi-panel-peak-brightness = <4300000>;
		qcom,mdss-dsi-panel-blackness-level = <1023>;
		qcom,mdss-pan-physical-width-dimension = <68>;
		qcom,mdss-pan-physical-height-dimension = <152>;
		qcom,esd-check-enabled;
		qcom,mdss-dsi-panel-status-check-mode = "reg_read";
		qcom,mdss-dsi-panel-status-command = [06 01 00 01 05 00 02 0A 00];
		qcom,mdss-dsi-panel-status-command-state = "dsi_hs_mode";
		qcom,mdss-dsi-panel-status-value = <0x9C>;
		qcom,mdss-dsi-panel-status-read-length = <1>;

		qcom,mdss-dsi-display-timings {
			timing@0{
				qcom,mdss-dsi-panel-clockrate = <1107000000>;
				qcom,mdss-mdp-transfer-time-us = <9000>;
				qcom,mdss-dsi-panel-width = <1080>;
				qcom,mdss-dsi-panel-height = <2400>;
				qcom,mdss-dsi-h-front-porch = <8>;
				qcom,mdss-dsi-h-back-porch = <8>;
				qcom,mdss-dsi-h-pulse-width = <24>;
				qcom,mdss-dsi-h-sync-skew = <0>;
				qcom,mdss-dsi-v-back-porch = <6>;
				qcom,mdss-dsi-v-front-porch = <8>;
				qcom,mdss-dsi-v-pulse-width = <4>;
				qcom,mdss-dsi-panel-framerate = <60>;
				//qcom,mdss-dsi-panel-phy-timings = [00 22 05 09 25 23 09 09 06 03 04 00];
				qcom,display-topology = <1 0 1>;
				qcom,default-topology-index = <0>;
				oplus,fod-on-vblank = <2>;
				oplus,fod-off-vblank = <0>;

				qcom,mdss-dsi-on-command = [
					39 01 00 00 00 00 03 F0 5A 5A
					39 01 00 00 00 00 03 FC 5A 5A
					39 01 00 00 00 00 02 B0 0C
					39 01 00 00 00 00 02 FF 10
					39 01 00 00 00 00 02 B0 22
					39 01 00 00 00 00 02 D1 1E
					39 01 00 00 00 00 03 F0 A5 A5
					39 01 00 00 0A 00 03 FC A5 A5
					05 01 00 00 15 00 01 11
					/* TE vsync ON */
					39 01 00 00 00 00 03 9F A5 A5
					15 01 00 00 00 00 02 35 00
					39 01 00 00 00 00 03 9F 5A 5A
					/* CASET/PASET Setting */
					39 01 00 00 00 00 05 2A 00 00 04 37
					39 01 00 00 00 00 05 2B 00 00 09 5F
					/* Err_FG Setting */
					//39 01 00 00 00 00 03 F0 5A 5A
					//39 01 00 00 00 00 03 FC 5A 5A
					//39 01 00 00 00 00 07 E1 00 00 02 02 42 02
					//39 01 00 00 00 00 07 E2 00 00 00 00 00 00
					//15 01 00 00 00 00 02 B0 0C
					//15 01 00 00 00 00 02 E1 19
					//39 01 00 00 00 00 03 F0 A5 A5
					//39 01 00 00 00 00 03 FC A5 A5
					/* FD Setting */
					39 01 00 00 00 00 03 F0 5A 5A
					15 01 00 00 00 00 02 B0 06
					15 01 00 00 00 00 02 D5 20
					39 01 00 00 00 00 03 F0 A5 A5
					/* TSP H_sync ON */
					//39 01 00 00 00 00 03 F0 5A 5A
					//15 01 00 00 00 00 02 B0 09
					//39 01 00 00 00 00 03 E8 10 30
					//39 01 00 00 00 00 03 F0 A5 A5
					/* ESD Setting */
					//39 01 00 00 00 00 03 FC 5A 5A
					//15 01 00 00 00 00 02 B0 01
					//15 01 00 00 00 00 02 E3 A8
					//15 01 00 00 00 00 02 B0 07
					//15 01 00 00 00 00 02 ED 67
					//39 01 00 00 3C 00 03 FC A5 A5
					/* Backlight Dimming Setting */
					39 01 00 00 00 00 03 F0 5A 5A
					39 01 00 00 00 00 02 B0 07
					39 01 00 00 00 00 02 B7 16
					39 01 00 00 00 00 03 F0 A5 A5
					39 01 00 00 00 00 02 53 20
					/* ACL off */
					15 01 00 00 00 00 02 55 00
					39 01 00 00 00 00 03 F0 5A 5A
					15 01 00 00 00 00 02 B0 DD
					15 01 00 00 00 00 02 B9 00
					39 01 00 00 00 00 03 F0 A5 A5
					/* FFC Setting 90.25M*/
					39 01 00 00 00 00 03 F0 5A 5A
					39 01 00 00 00 00 0C E9 11 65 A5 68 2C A9 12 8C 00 1A B8
					39 01 00 00 00 00 03 F0 A5 A5
					/* SPR Setting */
					39 01 00 00 00 00 03 F0 5A 5A
					39 01 00 00 00 00 03 B6 00 1A
					39 01 00 00 00 00 03 F0 A5 A5
					/* Seed CRC mode enable */
					39 01 00 00 00 00 03 81 92 02
					39 01 00 00 00 00 03 F0 5A 5A
					15 01 00 00 00 00 02 B0 2B
					39 01 00 00 00 00 16 B1 E8 00 04 00 FF 02 00 00 FF 14 FF DE FD 00 DE FF ED 00 FF FF FF
					39 01 00 00 00 00 02 B1 00
					39 01 00 00 00 00 03 F0 A5 A5
					/* Seed Tcs On */
					39 01 00 00 00 00 03 F0 5A 5A
					15 01 00 00 00 00 02 B0 22
					15 01 00 00 00 00 02 B3 91
					15 01 00 00 00 00 02 83 00
					15 01 00 00 00 00 02 B3 C0
					39 01 00 00 6F 00 03 F0 A5 A5
					/* Display On*/
					//39 01 00 00 6F 00 03 9F A5 A5
					//05 01 00 00 00 00 01 29
					//39 01 00 00 00 00 03 9F 5A 5A
					];
				qcom,mdss-dsi-post-on-backlight = [
					/* Display On*/
					39 01 00 00 00 00 03 9F A5 A5
					05 01 00 00 00 00 01 29
					05 01 00 00 00 00 01 13
					39 01 00 00 00 00 03 9F 5A 5A
				];
				qcom,mdss-dsi-off-command = [
					05 01 00 00 16 00 01 28
					05 01 00 00 96 00 01 10
				];
				qcom,mdss-dsi-lp1-command = [
					/*AOD on */
					39 01 00 00 00 00 03 F0 5A 5A
					39 01 00 00 00 00 02 60 00
					39 01 00 00 00 00 02 53 22
					39 01 00 00 00 00 02 B0 A3
					39 01 00 00 00 00 02 C7 00
					39 01 00 00 00 00 03 F0 A5 A5
				];
				qcom,mdss-dsi-nolp-command = [
					/* AOD off to normal*/
					//05 01 00 00 22 00 01 28
					15 01 00 00 00 00 02 53 20
					39 01 00 00 00 00 03 9F 5A 5A
					05 01 00 00 00 00 01 29
					39 01 00 00 00 00 03 9F A5 A5
				];
				qcom,mdss-dsi-aod-hbm-on-command = [
					/* HBM Mode ON */
					39 01 00 00 00 00 02 53 E0
					/* 0xE0 Normal transition */
					39 01 00 00 00 00 03 51 07 FF
				];
				qcom,mdss-dsi-aod-hbm-off-command = [
					15 01 00 00 00 00 02 53 22
					39 01 00 00 00 00 03 51 00 01
				];
				qcom,mdss-dsi-hbm-on-command = [
					15 01 00 00 00 00 02 53 E0
					39 01 00 00 22 00 03 51 07 FF
				];
				qcom,mdss-dsi-hbm-off-command = [
					15 01 00 00 00 00 02 53 20
				];
				qcom,mdss-dsi-normal-hbm-on-command = [
					15 01 00 00 00 00 02 53 E0
					39 01 00 00 00 00 03 51 07 FF
				];
				qcom,mdss-dsi-aod-high-mode-command = [
					/* AOD 50nit */
					15 01 00 00 00 00 02 53 22
				];
				qcom,mdss-dsi-aod-low-mode-command = [
					/* AOD 10nit */
					15 01 00 00 00 00 02 53 23
				];
				qcom,mdss-dsi-seed-off-command = [
					/* TCS OFF */
					39 01 00 00 00 00 03 F0 5A 5A
					15 01 00 00 00 00 02 B3 C1
					39 01 00 00 00 00 03 F0 A5 A5
					/* CRC OFF */
					39 01 00 00 00 00 03 F0 5A 5A
					15 01 00 00 00 00 02 81 00
					39 01 00 00 00 00 03 F0 A5 A5
				];
				qcom,mdss-dsi-seed-0-command = [
					/* SEED CRC Setting */
					39 01 00 00 00 00 03 81 92 02
					39 01 00 00 00 00 03 F0 5A 5A
					/* SEED CRC DCI-P3 */
					39 01 00 00 00 00 02 B0 2B
					39 01 00 00 00 00 16 B1 E8 00 04 00 FF 02 00 00 FF 14 FF DE FD 00 DE FF ED 00 FF FF FF
					/* SEED CRC ON */
					39 01 00 00 00 00 02 B1 00
					39 01 00 00 00 00 03 F0 A5 A5
				];
				qcom,mdss-dsi-seed-1-command = [
					/* SEED CRC Setting */
					39 01 00 00 00 00 03 81 90 00
					39 01 00 00 00 00 03 F0 5A 5A
					/* SEED CRC sRGB */
					39 01 00 00 00 00 02 B0 01
					39 01 00 00 00 00 16 B1 BB 01 05 39 D5 15 06 07 C1 47 F2 D5 CB 0B C1 F4 E8 1D FF FF FF
					/* SEED CRC ON */
					39 01 00 00 00 00 02 B1 00
					39 01 00 00 00 00 03 F0 A5 A5
				];
				qcom,mdss-dsi-seed-2-command = [
					/* SEED CRC Setting */
					39 01 00 00 00 00 03 81 92 02
					39 01 00 00 00 00 03 F0 5A 5A
					/* SEED CRC DCI-P3 */
					39 01 00 00 00 00 02 B0 2B
					39 01 00 00 00 00 16 B1 E8 00 04 00 FF 02 00 00 FF 14 FF DE FD 00 DE FF ED 00 FF FF FF
					/* SEED CRC ON */
					39 01 00 00 00 00 02 B1 00
					39 01 00 00 00 00 03 F0 A5 A5
				];
				qcom,mdss-dsi-osc-clk-mode0-command = [
					/* 90.25Mhz */
					39 01 00 00 00 00 03 F0 5A 5A
					39 01 00 00 00 00 0C E9 11 65 A5 68 2C A9 12 8C 00 1A B8
					39 01 00 00 00 00 03 F0 A5 A5
				];
				qcom,mdss-dsi-osc-clk-mode1-command = [
					/* 88.9Mhz */
					39 01 00 00 00 00 03 F0 5A 5A
					39 01 00 00 00 00 0C E9 11 65 A5 68 2C AB A3 D2 00 1A B8
					39 01 00 00 00 00 03 F0 A5 A5
				];
				qcom,mdss-dsi-seed-enter-command = [
					/*ENTER*/
					39 01 00 00 00 00 03 F0 5A 5A
					39 01 00 00 00 00 02 B0 1E
					39 01 00 00 00 00 08 B7 05 05 05 05 05 05 05
					39 01 00 00 00 00 03 F0 A5 A5
				];
				qcom,mdss-dsi-seed-exit-command = [
					/*EXIT*/
					39 01 00 00 00 00 03 F0 5A 5A
					39 01 00 00 00 00 02 B0 1E
					39 01 00 00 00 00 08 B7 05 04 03 03 01 00 00
					39 01 00 00 00 00 03 F0 A5 A5
				];
				qcom,mdss-dsi-aod-hbm-on-command-state = "dsi_hs_mode";
				qcom,mdss-dsi-aod-hbm-off-command-state = "dsi_hs_mode";
				qcom,mdss-dsi-hbm-off-command-state = "dsi_hs_mode";
				qcom,mdss-dsi-hbm-on-command-state = "dsi_hs_mode";
				qcom,mdss-dsi-on-command-state = "dsi_hs_mode";
				qcom,mdss-dsi-off-command-state = "dsi_hs_mode";
				qcom,mdss-dsi-seed-off-command-state = "dsi_hs_mode";
				qcom,mdss-dsi-seed-0-command-state = "dsi_hs_mode";
				qcom,mdss-dsi-seed-1-command-state = "dsi_hs_mode";
				qcom,mdss-dsi-seed-2-command-state = "dsi_hs_mode";
				qcom,mdss-dsi-osc-clk-mode0-command-state = "dsi_lp_mode";
				qcom,mdss-dsi-osc-clk-mode1-command-state = "dsi_lp_mode";
				qcom,mdss-dsi-seed-enter-command-state = "dsi_hs_mode";
				qcom,mdss-dsi-seed-exit-command-state = "dsi_hs_mode";
			};

		};
	};
};

&dsi_oplus19365samsung_ams643xf01_1080_2400_cmd {
	qcom,panel-supply-entries = <&dsi_panel_pwr_supply_labibb_amoled>;
	qcom,mdss-dsi-bl-pmic-control-type = "bl_ctrl_dcs";
	qcom,mdss-dsi-bl-min-level = <1>;
	qcom,mdss-dsi-bl-normal-max-level = <1023>;
	qcom,mdss-dsi-bl-max-level = <2047>;
	qcom,mdss-brightness-normal-max-level = <1023>;
	qcom,mdss-brightness-max-level = <2047>;
	qcom,mdss-dsi-bl-default-level = <400>;
	qcom,platform-te-gpio = <&tlmm 10 0>;
	qcom,platform-reset-gpio = <&pm6150l_gpios 3 0>;
	oplus,mdss-dsi-vendor-name = "ams643xf01";
	oplus,mdss-dsi-manufacture = "samsung1024";

	qcom,ulps-enabled;
	qcom,dsi-select-clocks = "mux_byte_clk0", "mux_pixel_clk0",
				"src_byte_clk0", "src_pixel_clk0",
				"shadow_byte_clk0", "shadow_pixel_clk0";
	qcom,mdss-dsi-t-clk-post = <0x1A>;
	qcom,mdss-dsi-t-clk-pre = <0x1F>;
	qcom,mdss-dsi-display-timings {
		timing@0{
			//qcom,mdss-dsi-panel-phy-timings = [00 1A 06 06 22 20 07 06 04 02 04 00];
			qcom,mdss-dsi-panel-phy-timings = [00 24 0A 0A 26 24 0A 0A 09 02 04 00];
			qcom,display-topology = <1 0 1>;
			qcom,default-topology-index = <0>;
		};
	};
};
