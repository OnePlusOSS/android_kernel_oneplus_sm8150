&mdss_mdp {
	dsi_oplus19696jdi_nt36672c_1080_2400_90fps_vid: qcom,mdss_dsi_oplus19696jdi_nt36672c_1080_2400_90fps_vid {
		qcom,mdss-dsi-panel-name =
		  "jdi nt36672c fhd ltps tft lcd panel with DSC";
		qcom,mdss-dsi-panel-type = "dsi_video_mode";
		qcom,mdss-dsi-virtual-channel-id = <0>;
		qcom,mdss-dsi-stream = <0>;
		qcom,mdss-dsi-bpp = <24>;
		qcom,mdss-dsi-color-order = "rgb_swap_rgb";
		qcom,mdss-dsi-underflow-color = <0xff>;
		qcom,mdss-dsi-border-color = <0>;

		qcom,dsi-ctrl-num = <0>;
		qcom,dsi-phy-num = <0>;
		qcom,dsi-select-clocks = "src_byte_clk0", "src_pixel_clk0";

		qcom,mdss-dsi-traffic-mode = "burst_mode";
		qcom,mdss-dsi-lane-map = "lane_map_0123";
		qcom,mdss-dsi-bllp-eof-power-mode;
		qcom,mdss-dsi-bllp-power-mode;
		qcom,mdss-dsi-lane-0-state;
		qcom,mdss-dsi-lane-1-state;
		qcom,mdss-dsi-lane-2-state;
		qcom,mdss-dsi-lane-3-state;
		qcom,mdss-pan-physical-width-dimension = <69>;
		qcom,mdss-pan-physical-height-dimension = <152>;
		qcom,mdss-dsi-dma-trigger = "trigger_sw";
		qcom,mdss-dsi-mdp-trigger = "none";
		qcom,mdss-dsi-reset-sequence = <1 10>, <0 3>, <1 1>;
		qcom,mdss-dsi-te-pin-select = <1>;
		qcom,mdss-dsi-wr-mem-start = <0x2c>;
		qcom,mdss-dsi-wr-mem-continue = <0x3c>;
		qcom,mdss-dsi-te-dcs-command = <1>;
		qcom,mdss-dsi-te-check-enable;
		qcom,mdss-dsi-te-using-te-pin;
		qcom,mdss-dsi-panel-hdr-enabled;
		qcom,mdss-dsi-panel-hdr-color-primaries = <15000 15500 34000
			16000 13250 34500 7500 3000>;
		qcom,mdss-dsi-panel-peak-brightness = <4300000>;
		qcom,mdss-dsi-panel-blackness-level = <1023>;
		qcom,mdss-brightness-max-level = <1023>;

		qcom,mdss-dsi-display-timings {
			timing@0{
				//qcom,mdss-dsi-panel-clockrate = <1107000000>;
				qcom,mdss-mdp-transfer-time-us = <7000>;
				qcom,mdss-dsi-panel-framerate = <60>; /* 60 FPS */
				qcom,mdss-dsi-panel-width = <1080>;
				qcom,mdss-dsi-panel-height = <2400>;
				qcom,mdss-dsi-h-front-porch = <124>;
				qcom,mdss-dsi-h-back-porch = <128>;
				qcom,mdss-dsi-h-pulse-width = <8>;
				qcom,mdss-dsi-h-sync-skew = <0>;
				qcom,mdss-dsi-h-sync-pulse = <0>;
				qcom,mdss-dsi-v-back-porch = <10>;
				qcom,mdss-dsi-v-front-porch = <2528>;
				qcom,mdss-dsi-v-pulse-width = <10>;
				qcom,mdss-dsi-h-left-border = <0>;
				qcom,mdss-dsi-h-right-border = <0>;
				qcom,mdss-dsi-v-top-border = <0>;
				qcom,mdss-dsi-v-bottom-border = <0>;
				qcom,mdss-dsi-panel-jitter = <0x4 0x1>;


				qcom,mdss-dsi-on-command = [
					29 01 00 00 00 00 02 FF C0
					29 01 00 00 0A 00 02 4B 1F

					29 01 00 00 00 00 02 FF C0
					29 01 00 00 00 00 02 4B 0E

					29 01 00 00 00 00 02 FF 2A
					29 01 00 00 00 00 02 FB 01
					29 01 00 00 00 00 02 27 80
					29 01 00 00 00 00 02 28 FD

					39 01 00 00 00 00 02 FF 10
					39 01 00 00 00 00 02 FB 01
					39 01 00 00 00 00 02 B0 00

					39 01 00 00 00 00 02 C0 03
					39 01 00 00 00 00 03 C2 1B A0

					29 01 00 00 00 00 02 FF 23
					29 01 00 00 00 00 02 FB 01
					29 01 00 00 00 00 02 00 80 //12Bit
					//PWM frequency 25K
					29 01 00 00 00 00 02 07 00
					29 01 00 00 00 00 02 08 01
					29 01 00 00 00 00 02 09 0F

					29 01 00 00 00 00 02 0A 00
					29 01 00 00 00 00 02 0B 00
					29 01 00 00 00 00 02 0C 00
					29 01 00 00 00 00 02 0D 00
					29 01 00 00 00 00 02 10 50
					29 01 00 00 00 00 02 11 01
					29 01 00 00 00 00 02 12 95
					29 01 00 00 00 00 02 15 68
					29 01 00 00 00 00 02 16 0B

29 01 00 00 00 00 02 30 FA
29 01 00 00 00 00 02 31 F9
29 01 00 00 00 00 02 32 F8
29 01 00 00 00 00 02 33 F7
29 01 00 00 00 00 02 34 F6
29 01 00 00 00 00 02 35 F5
29 01 00 00 00 00 02 36 F3
29 01 00 00 00 00 02 37 F2
29 01 00 00 00 00 02 38 F1
29 01 00 00 00 00 02 39 F0
29 01 00 00 00 00 02 3A ED
29 01 00 00 00 00 02 3B EB
29 01 00 00 00 00 02 3D E9
29 01 00 00 00 00 02 3F E7
29 01 00 00 00 00 02 40 E6
29 01 00 00 00 00 02 41 E5

29 01 00 00 00 00 02 45 EA
29 01 00 00 00 00 02 46 E0
29 01 00 00 00 00 02 47 D6
29 01 00 00 00 00 02 48 CE
29 01 00 00 00 00 02 49 C7
29 01 00 00 00 00 02 4A C2
29 01 00 00 00 00 02 4B BE
29 01 00 00 00 00 02 4C BB
29 01 00 00 00 00 02 4D B9
29 01 00 00 00 00 02 4E B9
29 01 00 00 00 00 02 4F B9
29 01 00 00 00 00 02 50 B9
29 01 00 00 00 00 02 51 B9
29 01 00 00 00 00 02 52 B9
29 01 00 00 00 00 02 53 B9
29 01 00 00 00 00 02 54 B9

29 01 00 00 00 00 02 58 DC
29 01 00 00 00 00 02 59 D3
29 01 00 00 00 00 02 5A CA
29 01 00 00 00 00 02 5B C1
29 01 00 00 00 00 02 5C B8
29 01 00 00 00 00 02 5D B0
29 01 00 00 00 00 02 5E A8
29 01 00 00 00 00 02 5F 9F
29 01 00 00 00 00 02 60 94
29 01 00 00 00 00 02 61 90
29 01 00 00 00 00 02 62 8B
29 01 00 00 00 00 02 63 86
29 01 00 00 00 00 02 64 7F
29 01 00 00 00 00 02 65 7B
29 01 00 00 00 00 02 66 77
29 01 00 00 00 00 02 67 73
					29 01 00 00 00 00 02 A0 11

					29 01 00 00 00 00 02 FF 10
					29 01 00 00 00 00 02 FB 01
					29 01 00 00 00 00 03 51 0F FF
					29 01 00 00 00 00 02 53 2C
					29 01 00 00 00 00 02 55 01


39 01 00 00 00 00 02 FF 20
39 01 00 00 00 00 02 FB 01
39 01 00 00 00 00 02 01 66
39 01 00 00 00 00 02 06 40
39 01 00 00 00 00 02 07 38
39 01 00 00 00 00 02 69 91
39 01 00 00 00 00 02 89 17
39 01 00 00 00 00 02 95 D1
39 01 00 00 00 00 02 96 D1
39 01 00 00 00 00 02 F2 64
39 01 00 00 00 00 02 F4 64
39 01 00 00 00 00 02 F6 64
39 01 00 00 00 00 02 F8 64


39 01 00 00 00 00 02 FF 20
39 01 00 00 00 00 02 FB 01

39 01 00 00 00 00 11 B0 00 00 00 1E 00 47 00 67 00 82 00 99 00 AE 00 C0
39 01 00 00 00 00 11 B1 00 D1 01 09 01 32 01 73 01 A2 01 ED 02 26 02 27
39 01 00 00 00 00 11 B2 02 60 02 9E 02 C8 02 FA 03 20 03 49 03 59 03 68
39 01 00 00 00 00 0F B3 03 7B 03 91 03 AC 03 C5 03 D6 03 D8 00 00

39 01 00 00 00 00 11 B4 00 00 00 1E 00 47 00 67 00 82 00 99 00 AE 00 C0
39 01 00 00 00 00 11 B5 00 D1 01 09 01 32 01 73 01 A2 01 ED 02 26 02 27
39 01 00 00 00 00 11 B6 02 60 02 9E 02 C8 02 FA 03 20 03 49 03 59 03 68
39 01 00 00 00 00 0F B7 03 7B 03 91 03 AC 03 C5 03 D6 03 D8 00 00

39 01 00 00 00 00 11 B8 00 00 00 1E 00 47 00 67 00 82 00 99 00 AE 00 C0
39 01 00 00 00 00 11 B9 00 D1 01 09 01 32 01 73 01 A2 01 ED 02 26 02 27
39 01 00 00 00 00 11 BA 02 60 02 9E 02 C8 02 FA 03 20 03 49 03 59 03 68
39 01 00 00 00 00 0F BB 03 7B 03 91 03 AC 03 C5 03 D6 03 D8 00 00

39 01 00 00 00 00 02 FF 21
39 01 00 00 00 00 02 FB 01

39 01 00 00 00 00 11 B0 00 00 00 1E 00 47 00 67 00 82 00 99 00 AE 00 C0
39 01 00 00 00 00 11 B1 00 D1 01 09 01 32 01 73 01 A2 01 ED 02 26 02 27
39 01 00 00 00 00 11 B2 02 60 02 9E 02 C8 02 FA 03 20 03 49 03 59 03 68
39 01 00 00 00 00 0F B3 03 7B 03 91 03 AC 03 C5 03 D6 03 D8 00 00

39 01 00 00 00 00 11 B4 00 00 00 1E 00 47 00 67 00 82 00 99 00 AE 00 C0
39 01 00 00 00 00 11 B5 00 D1 01 09 01 32 01 73 01 A2 01 ED 02 26 02 27
39 01 00 00 00 00 11 B6 02 60 02 9E 02 C8 02 FA 03 20 03 49 03 59 03 68
39 01 00 00 00 00 0F B7 03 7B 03 91 03 AC 03 C5 03 D6 03 D8 00 00

39 01 00 00 00 00 11 B8 00 00 00 1E 00 47 00 67 00 82 00 99 00 AE 00 C0
39 01 00 00 00 00 11 B9 00 D1 01 09 01 32 01 73 01 A2 01 ED 02 26 02 27
39 01 00 00 00 00 11 BA 02 60 02 9E 02 C8 02 FA 03 20 03 49 03 59 03 68
39 01 00 00 00 00 0F BB 03 7B 03 91 03 AC 03 C5 03 D6 03 D8 00 00

39 01 00 00 00 00 02 FF 24
39 01 00 00 00 00 02 FB 01
39 01 00 00 00 00 02 01 0F
39 01 00 00 00 00 02 03 0C
39 01 00 00 00 00 02 05 1D
39 01 00 00 00 00 02 08 2F
39 01 00 00 00 00 02 09 2E
39 01 00 00 00 00 02 0A 2D
39 01 00 00 00 00 02 0B 2C
39 01 00 00 00 00 02 11 17
39 01 00 00 00 00 02 12 13
39 01 00 00 00 00 02 13 15
39 01 00 00 00 00 02 15 14
39 01 00 00 00 00 02 16 16
39 01 00 00 00 00 02 17 18
39 01 00 00 00 00 02 1B 01
39 01 00 00 00 00 02 1D 1D
39 01 00 00 00 00 02 20 2F
39 01 00 00 00 00 02 21 2E
39 01 00 00 00 00 02 22 2D
39 01 00 00 00 00 02 23 2C
39 01 00 00 00 00 02 29 17
39 01 00 00 00 00 02 2A 13
39 01 00 00 00 00 02 2B 15
39 01 00 00 00 00 02 2F 14
39 01 00 00 00 00 02 30 16
39 01 00 00 00 00 02 31 18
39 01 00 00 00 00 02 32 04
39 01 00 00 00 00 02 34 10
39 01 00 00 00 00 02 35 1F
39 01 00 00 00 00 02 36 1F
39 01 00 00 00 00 02 37 20
39 01 00 00 00 00 02 4D 1B
39 01 00 00 00 00 02 4E 4B
39 01 00 00 00 00 02 4F 4B
39 01 00 00 00 00 02 53 4B
39 01 00 00 00 00 02 71 30
39 01 00 00 00 00 02 79 11
39 01 00 00 00 00 02 7A 82
39 01 00 00 00 00 02 7B 96
39 01 00 00 00 00 02 7D 04
39 01 00 00 00 00 02 80 04
39 01 00 00 00 00 02 81 04
39 01 00 00 00 00 02 82 13
39 01 00 00 00 00 02 84 31
39 01 00 00 00 00 02 85 00
39 01 00 00 00 00 02 86 00
39 01 00 00 00 00 02 87 00
39 01 00 00 00 00 02 90 13
39 01 00 00 00 00 02 92 31
39 01 00 00 00 00 02 93 00
39 01 00 00 00 00 02 94 00
39 01 00 00 00 00 02 95 00
39 01 00 00 00 00 02 9C F4
39 01 00 00 00 00 02 9D 01
39 01 00 00 00 00 02 A0 16
39 01 00 00 00 00 02 A2 16
39 01 00 00 00 00 02 A3 02
39 01 00 00 00 00 02 A4 04
39 01 00 00 00 00 02 A5 04
39 01 00 00 00 00 02 C9 00
39 01 00 00 00 00 02 D9 80
39 01 00 00 00 00 02 E9 02

39 01 00 00 00 00 02 FF 25
39 01 00 00 00 00 02 FB 01
39 01 00 00 00 00 02 19 E4
39 01 00 00 00 00 02 21 40
39 01 00 00 00 00 02 66 D8
39 01 00 00 00 00 02 68 50
39 01 00 00 00 00 02 69 10
39 01 00 00 00 00 02 6B 00
39 01 00 00 00 00 02 6D 0D
39 01 00 00 00 00 02 6E 48
39 01 00 00 00 00 02 72 41
39 01 00 00 00 00 02 73 4A
39 01 00 00 00 00 02 74 D0
39 01 00 00 00 00 02 76 83
39 01 00 00 00 00 02 77 62
39 01 00 00 00 00 02 79 81
39 01 00 00 00 00 02 7D 03
39 01 00 00 00 00 02 7E 15
39 01 00 00 00 00 02 7F 00
39 01 00 00 00 00 02 84 4D
39 01 00 00 00 00 02 CF 80
39 01 00 00 00 00 02 D6 80
39 01 00 00 00 00 02 D7 80
39 01 00 00 00 00 02 EF 20
39 01 00 00 00 00 02 F0 84

39 01 00 00 00 00 02 FF 26
39 01 00 00 00 00 02 FB 01
39 01 00 00 00 00 02 80 01
39 01 00 00 00 00 02 81 16
39 01 00 00 00 00 02 83 03
39 01 00 00 00 00 02 84 03
39 01 00 00 00 00 02 85 01
39 01 00 00 00 00 02 86 03
39 01 00 00 00 00 02 87 01
39 01 00 00 00 00 02 8A 1A
39 01 00 00 00 00 02 8B 11
39 01 00 00 00 00 02 8C 24
39 01 00 00 00 00 02 8E 42
39 01 00 00 00 00 02 8F 11
39 01 00 00 00 00 02 90 11
39 01 00 00 00 00 02 91 11
39 01 00 00 00 00 02 9A 81
39 01 00 00 00 00 02 9B 03
39 01 00 00 00 00 02 9C 00
39 01 00 00 00 00 02 9D 00
39 01 00 00 00 00 02 9E 00

39 01 00 00 00 00 02 FF 27
39 01 00 00 00 00 02 FB 01
39 01 00 00 00 00 02 01 60
39 01 00 00 00 00 02 20 81
39 01 00 00 00 00 02 21 EA
39 01 00 00 00 00 02 25 82
39 01 00 00 00 00 02 26 1F
39 01 00 00 00 00 02 6E 00
39 01 00 00 00 00 02 6F 00
39 01 00 00 00 00 02 70 00
39 01 00 00 00 00 02 71 00
39 01 00 00 00 00 02 72 00
39 01 00 00 00 00 02 75 00
39 01 00 00 00 00 02 76 00
39 01 00 00 00 00 02 77 00
39 01 00 00 00 00 02 7D 09
39 01 00 00 00 00 02 7E 5F
39 01 00 00 00 00 02 80 23
39 01 00 00 00 00 02 82 09
39 01 00 00 00 00 02 83 5F
39 01 00 00 00 00 02 88 01
39 01 00 00 00 00 02 89 10
39 01 00 00 00 00 02 A5 10
39 01 00 00 00 00 02 A6 23
39 01 00 00 00 00 02 A7 01
39 01 00 00 00 00 02 B6 40
39 01 00 00 00 00 02 E3 02
39 01 00 00 00 00 02 E4 E0
39 01 00 00 00 00 02 E5 01
39 01 00 00 00 00 02 E6 70
39 01 00 00 00 00 02 E9 03
39 01 00 00 00 00 02 EA 2F
39 01 00 00 00 00 02 EB 01
39 01 00 00 00 00 02 EC 98

39 01 00 00 00 00 02 FF 2A
39 01 00 00 00 00 02 FB 01
39 01 00 00 00 00 02 00 91
39 01 00 00 00 00 02 03 20
39 01 00 00 00 00 02 07 52
39 01 00 00 00 00 02 0A 60
39 01 00 00 00 00 02 0C 06
39 01 00 00 00 00 02 0D 40
39 01 00 00 00 00 02 0E 02
39 01 00 00 00 00 02 0F 01
39 01 00 00 00 00 02 11 58
39 01 00 00 00 00 02 15 0E
39 01 00 00 00 00 02 16 79
39 01 00 00 00 00 02 19 0D
39 01 00 00 00 00 02 1A F2
39 01 00 00 00 00 02 1B 14
39 01 00 00 00 00 02 1D 36
39 01 00 00 00 00 02 1E 55
39 01 00 00 00 00 02 1F 55
39 01 00 00 00 00 02 20 55
39 01 00 00 00 00 02 28 0A
39 01 00 00 00 00 02 29 0B
39 01 00 00 00 00 02 2A 4B
39 01 00 00 00 00 02 2B 05
39 01 00 00 00 00 02 2D 08
39 01 00 00 00 00 02 2F 01
39 01 00 00 00 00 02 30 47
39 01 00 00 00 00 02 31 23
39 01 00 00 00 00 02 33 25
39 01 00 00 00 00 02 34 FF
39 01 00 00 00 00 02 35 2C
39 01 00 00 00 00 02 36 75
39 01 00 00 00 00 02 37 FB
39 01 00 00 00 00 02 38 2E
39 01 00 00 00 00 02 39 73
39 01 00 00 00 00 02 3A 47
39 01 00 00 00 00 02 46 40
39 01 00 00 00 00 02 47 02
39 01 00 00 00 00 02 4A F0
39 01 00 00 00 00 02 4E 0E
39 01 00 00 00 00 02 4F 8B
39 01 00 00 00 00 02 52 0E
39 01 00 00 00 00 02 53 04
39 01 00 00 00 00 02 54 14
39 01 00 00 00 00 02 56 36
39 01 00 00 00 00 02 57 80
39 01 00 00 00 00 02 58 80
39 01 00 00 00 00 02 59 80
39 01 00 00 00 00 02 60 80
39 01 00 00 00 00 02 61 0A
39 01 00 00 00 00 02 62 03
39 01 00 00 00 00 02 63 ED
39 01 00 00 00 00 02 65 05
39 01 00 00 00 00 02 66 01
39 01 00 00 00 00 02 67 04
39 01 00 00 00 00 02 68 4D
39 01 00 00 00 00 02 6A 0A
39 01 00 00 00 00 02 6B C9
39 01 00 00 00 00 02 6C 1D
39 01 00 00 00 00 02 6D E5
39 01 00 00 00 00 02 6E C6
39 01 00 00 00 00 02 6F 1E
39 01 00 00 00 00 02 70 E4
39 01 00 00 00 00 02 71 04
39 01 00 00 00 00 02 7A 04
39 01 00 00 00 00 02 7B 40
39 01 00 00 00 00 02 7C 01
39 01 00 00 00 00 02 7D 01
39 01 00 00 00 00 02 7F E0
39 01 00 00 00 00 02 83 0E
39 01 00 00 00 00 02 84 8B
39 01 00 00 00 00 02 87 0E
39 01 00 00 00 00 02 88 04
39 01 00 00 00 00 02 89 14
39 01 00 00 00 00 02 8B 36
39 01 00 00 00 00 02 8C 40
39 01 00 00 00 00 02 8D 40
39 01 00 00 00 00 02 8E 40
39 01 00 00 00 00 02 95 80
39 01 00 00 00 00 02 96 0A
39 01 00 00 00 00 02 97 12
39 01 00 00 00 00 02 98 92
39 01 00 00 00 00 02 9A 0A
39 01 00 00 00 00 02 9B 02
39 01 00 00 00 00 02 9C 49
39 01 00 00 00 00 02 9D 98
39 01 00 00 00 00 02 9E 5F
39 01 00 00 00 00 02 A0 FF
39 01 00 00 00 00 02 A2 3A
39 01 00 00 00 00 02 A3 D9
39 01 00 00 00 00 02 A4 FA
39 01 00 00 00 00 02 A5 3C
39 01 00 00 00 00 02 A6 D7
39 01 00 00 00 00 02 A7 49

39 01 00 00 00 00 02 FF 2C
39 01 00 00 00 00 02 FB 01
39 01 00 00 00 00 02 00 02
39 01 00 00 00 00 02 01 02
39 01 00 00 00 00 02 02 02
39 01 00 00 00 00 02 03 16
39 01 00 00 00 00 02 04 16
39 01 00 00 00 00 02 05 16
39 01 00 00 00 00 02 0D 1F
39 01 00 00 00 00 02 0E 1F
39 01 00 00 00 00 02 16 1B
39 01 00 00 00 00 02 17 4B
39 01 00 00 00 00 02 18 4B
39 01 00 00 00 00 02 19 4B
39 01 00 00 00 00 02 2A 03
39 01 00 00 00 00 02 3B 01
39 01 00 00 00 00 02 4D 16
39 01 00 00 00 00 02 4E 03
39 01 00 00 00 00 02 53 02
39 01 00 00 00 00 02 54 02
39 01 00 00 00 00 02 55 02
39 01 00 00 00 00 02 56 0F
39 01 00 00 00 00 02 58 0F
39 01 00 00 00 00 02 59 0F
39 01 00 00 00 00 02 61 1F
39 01 00 00 00 00 02 62 1F
39 01 00 00 00 00 02 6A 15
39 01 00 00 00 00 02 6B 37
39 01 00 00 00 00 02 6C 37
39 01 00 00 00 00 02 6D 37
39 01 00 00 00 00 02 7E 03
39 01 00 00 00 00 02 9D 10
39 01 00 00 00 00 02 9E 03


					39 01 00 00 00 00 02 FF F0
					39 01 00 00 00 00 02 FB 01
					39 01 00 00 00 00 02 5A 00

39 01 00 00 00 00 02 FF 25
39 01 00 00 00 00 02 FB 01
39 01 00 00 00 00 02 18 22

39 01 00 00 00 00 02 FF E0
39 01 00 00 00 00 02 FB 01
39 01 00 00 00 00 02 35 82
39 01 00 00 00 00 02 FF C0
39 01 00 00 00 00 02 FB 01
39 01 00 00 00 00 02 9C 11
39 01 00 00 00 00 02 9D 11

					39 01 00 00 00 00 02 FF 10
					39 01 00 00 00 00 02 FB 01
					39 01 00 00 00 00 02 35 00
					05 01 00 00 78 00 01 11
					05 01 00 00 00 00 01 29];
				qcom,mdss-dsi-off-command = [
					39 01 00 00 00 00 02 FF 10
					39 01 00 00 00 00 02 FB 01
					05 01 00 00 0A 00 01 28
					05 01 00 00 78 00 01 10];

				qcom,mdss-dsi-cabc-off-command = [
					29 01 00 00 00 00 02 FF 10
					29 01 00 00 00 00 02 FB 01
					29 01 00 00 00 00 03 51 0F FF
					29 01 00 00 00 00 02 53 2C
					29 01 00 00 00 00 02 55 00];
				qcom,mdss-dsi-cabc-ui-command = [
					29 01 00 00 00 00 02 FF 10
					29 01 00 00 00 00 02 FB 01
					29 01 00 00 00 00 03 51 0F FF
					29 01 00 00 00 00 02 53 2C
					29 01 00 00 00 00 02 55 01];
				qcom,mdss-dsi-cabc-still-image-command = [
					29 01 00 00 00 00 02 FF 10
					29 01 00 00 00 00 02 FB 01
					29 01 00 00 00 00 03 51 0F FF
					29 01 00 00 00 00 02 53 2C
					29 01 00 00 00 00 02 55 02];
				qcom,mdss-dsi-cabc-video-command = [
					29 01 00 00 00 00 02 FF 10
					29 01 00 00 00 00 02 FB 01
					29 01 00 00 00 00 03 51 0F FF
					29 01 00 00 00 00 02 53 2C
					29 01 00 00 00 00 02 55 03];

				qcom,mdss-dsi-cabc-off-command-state = "dsi_hs_mode";
				qcom,mdss-dsi-cabc-ui-command-state = "dsi_hs_mode";
				qcom,mdss-dsi-cabc-still-image-command-state = "dsi_hs_mode";
				qcom,mdss-dsi-cabc-video-command-state = "dsi_hs_mode";
				qcom,mdss-dsi-on-command-state = "dsi_lp_mode";
				qcom,mdss-dsi-off-command-state = "dsi_hs_mode";
				qcom,compression-mode = "dsc";
				qcom,mdss-dsc-slice-height = <20>;
				qcom,mdss-dsc-slice-width = <540>;
				qcom,mdss-dsc-slice-per-pkt = <2>;
				qcom,mdss-dsc-bit-per-component = <8>;
				qcom,mdss-dsc-bit-per-pixel = <8>;
				qcom,mdss-dsc-block-prediction-enable;
			};
		};
	};
};

