/* Copyright (c) 2014-2018, The Linux Foundation. All rights reserved.
 *
 * This program is free software; you can redistribute it and/or modify
 * it under the terms of the GNU General Public License version 2 and
 * only version 2 as published by the Free Software Foundation.
 *
 * This program is distributed in the hope that it will be useful,
 * but WITHOUT ANY WARRANTY; without even the implied warranty of
 * MERCHANTABILITY or FITNESS FOR A PARTICULAR PURPOSE.  See the
 * GNU General Public License for more details.
 */

&mdss_mdp {
	dsi_oplus19031samsung_ams655ue01_1080_2400_61fps_cmd: qcom,mdss_dsi_oplus19031samsung_ams655ue01_1080_2400_61fps_cmd {
		qcom,panel-supply-entries = <&dsi_panel_pwr_supply_labibb_amoled>;

		qcom,platform-te-gpio = <&tlmm 10 0>;
		qcom,platform-reset-gpio = <&pm6150l_gpios 9 0>;

		qcom,mdss-dsi-panel-name = "oplus19031samsung AMS655MGN61 1080 2400 61fps cmd mode dsi panel";
		qcom,mdss-dsi-panel-type = "dsi_cmd_mode";
		qcom,mdss-dsi-virtual-channel-id = <0>;
		qcom,mdss-dsi-stream = <0>;
		qcom,mdss-dsi-bpp = <24>;
		qcom,mdss-dsi-underflow-color = <0xff>;
		qcom,mdss-dsi-border-color = <0>;
		qcom,mdss-dsi-color-order = "rgb_swap_rgb";
		qcom,mdss-dsi-traffic-mode = "non_burst_sync_pulse";
		qcom,mdss-dsi-lane-map = "lane_map_0123";
		qcom,mdss-dsi-bllp-eof-power-mode;
		qcom,mdss-dsi-bllp-power-mode;
		qcom,mdss-dsi-lane-0-state;
		qcom,mdss-dsi-lane-1-state;
		qcom,mdss-dsi-lane-2-state;
		qcom,mdss-dsi-lane-3-state;
		qcom,mdss-pan-physical-width-dimension = <68>;
		qcom,mdss-pan-physical-height-dimension = <152>;
		qcom,mdss-dsi-reset-sequence = <1 5>, <0 2>, <1 1>;
		qcom,mdss-dsi-dma-trigger = "trigger_sw";
		qcom,mdss-dsi-mdp-trigger = "none";
		qcom,mdss-dsi-t-clk-post = <0x1a>;
		qcom,mdss-dsi-t-clk-pre = <0x39>;
		qcom,mdss-dsi-wr-mem-start = <0x2c>;
		qcom,mdss-dsi-wr-mem-continue = <0x3c>;
		qcom,mdss-dsi-te-pin-select = <1>;
		qcom,mdss-dsi-te-dcs-command = <1>;
		qcom,mdss-dsi-te-check-enable;
		qcom,mdss-dsi-te-using-te-pin;
		qcom,mdss-dsi-bl-pmic-control-type = "bl_ctrl_dcs";
		qcom,mdss-dsi-bl-min-level = <1>;
		qcom,mdss-dsi-bl-max-level = <2047>;
		qcom,mdss-brightness-max-level = <2047>;
		qcom,mdss-dsi-panel-jitter = <0x4 0x1>;

		qcom,esd-check-enabled;
		qcom,mdss-dsi-panel-status-read-length = <1>;
		qcom,mdss-dsi-panel-status-check-mode="reg_read";
		qcom,mdss-dsi-panel-status-command = [06 01 00 01 05 00 02 0A 08];
		qcom,mdss-dsi-panel-status-command-state = "dsi_hs_mode";
		qcom,mdss-dsi-panel-status-value = <0x9C>;
		qcom,mdss-dsi-panel-on-check-value = <0x9C>;
		qcom,mdss-dsi-panel-hdr-enabled;
		qcom,mdss-dsi-panel-hdr-color-primaries = <15000 15500 34000
		16000 13250 34500 7500 3000>;
		qcom,mdss-dsi-panel-peak-brightness = <5000000>;
		qcom,mdss-dsi-panel-blackness-level = <84>;
		qcom,mdss-dsi-display-timings {
			timing@0{
				qcom,mdss-dsi-panel-width = <1080>;
				qcom,mdss-dsi-panel-height = <2400>;
				qcom,mdss-dsi-h-front-porch = <24>;
				qcom,mdss-dsi-h-back-porch = <8>;
				qcom,mdss-dsi-h-pulse-width = <8>;
				qcom,mdss-dsi-h-sync-skew = <0>;
				qcom,mdss-dsi-v-back-porch = <16>;
				qcom,mdss-dsi-v-front-porch = <16>;
				qcom,mdss-dsi-v-pulse-width = <4>;
				qcom,mdss-dsi-panel-framerate = <61>;
				qcom,mdss-dsi-panel-clockrate = <998000000>;
				qcom,mdss-dsi-panel-phy-timings = [00 10 08 09 25 0F 09 0A 07 02 04 00];
				qcom,display-topology = <1 0 1>;
				qcom,default-topology-index = <0>;

				qcom,mdss-dsi-on-command = [
					39 01 00 00 00 00 03 9F A5 A5
					05 01 00 00 05 00 01 11
					39 01 00 00 00 00 03 9F 5A 5A
					/* TE vsync ON */
					39 01 00 00 00 00 03 9F A5 A5
					15 01 00 00 00 00 02 35 00
					39 01 00 00 00 00 03 9F 5A 5A
					/* CASET/PASET Setting */
					39 01 00 00 00 00 05 2A 00 00 04 37
					39 01 00 00 00 00 05 2B 00 00 09 5F
					/* ESD Setting */
					39 01 00 00 00 00 03 FC 5A 5A
					15 01 00 00 00 00 02 B0 07
					15 01 00 00 00 00 02 B7 01
					15 01 00 00 00 00 02 B0 07
					15 01 00 00 00 00 02 B7 12
					39 01 00 00 3C 00 03 FC A5 A5
					15 01 00 00 00 00 02 53 28
					/* ACL off */
					15 01 00 00 00 00 02 55 00
					39 01 00 00 00 00 03 F0 5A 5A
					15 01 00 00 00 00 02 B0 DD
					15 01 00 00 00 00 02 B9 00
					39 01 00 00 00 00 03 F0 A5 A5
					/* CRC mode enable */
					39 01 00 00 00 00 02 81 92
					39 01 00 00 00 00 03 F0 5A 5A
					39 01 00 00 00 00 02 B0 2B
					39 01 00 00 00 00 16 B1 DD 00 00 16 E8 01 0F 09 FF 28 FF E8 FA 08 E4 F4 EC 01 FF FF FF  /* CRC LUT */
					39 01 00 00 00 00 02 B1 00
					39 01 00 00 00 00 03 F0 A5 A5
					39 01 00 00 00 00 03 F0 5A 5A  /* Seed Tcs On */
					39 01 00 00 00 00 02 B0 22
					39 01 00 00 00 00 02 B3 91
					39 01 00 00 00 00 02 83 80
					39 01 00 00 00 00 02 B3 C0
					39 01 00 00 00 00 03 F0 A5 A5];
				qcom,mdss-dsi-post-on-backlight = [
					39 01 00 00 00 00 03 9F A5 A5
					05 01 00 00 00 00 01 29
					39 01 00 00 00 00 03 9F 5A 5A];
				qcom,mdss-dsi-off-command = [
					39 01 00 00 00 00 03 9F A5 A5
					05 01 00 00 0A 00 01 28
					05 01 00 00 00 00 01 10
					39 01 00 00 00 00 03 9F 5A 5A
					39 01 00 00 00 00 03 F0 5A 5A
					15 01 00 00 00 00 02 B0 05
					15 01 00 00 00 00 02 F4 01
					39 01 00 00 96 00 03 F0 A5 A5];
				qcom,mdss-dsi-lp1-command = [    /* AOD ON */
					39 01 00 00 00 00 03 9F A5 A5
					05 01 00 00 0A 00 01 28
					05 01 00 00 00 00 01 10
					39 01 00 00 00 00 03 9F 5A 5A
					39 01 00 00 00 00 03 F0 5A 5A
					15 01 00 00 00 00 02 B0 05
					15 01 00 00 00 00 02 F4 01
					39 01 00 00 78 00 03 F0 A5 A5
					39 01 00 00 00 00 03 9F A5 A5
					05 01 00 00 05 00 01 11
					39 01 00 00 00 00 03 9F 5A 5A
					/* AOD ON */
					39 01 00 00 00 00 03 F0 5A 5A
					15 01 00 00 00 00 02 53 22
					15 01 00 00 00 00 02 B0 A5
					15 01 00 00 73 00 02 C7 00
					39 01 00 00 00 00 03 F0 A5 A5];
				qcom,mdss-dsi-nolp-command = [    /* AOD OFF */
					/*AOD OFF*/
					39 01 00 00 00 00 02 53 20
					/* TE vsync ON */
					39 01 00 00 00 00 03 9F A5 A5
					15 01 00 00 00 00 02 35 00
					39 01 00 00 00 00 03 9F 5A 5A
					/* CASET/PASET Setting */
					39 01 00 00 00 00 05 2A 00 00 04 37
					39 01 00 00 00 00 05 2B 00 00 09 5F
					/* ESD Setting */
					39 01 00 00 00 00 03 FC 5A 5A
					15 01 00 00 00 00 02 B0 07
					15 01 00 00 00 00 02 B7 01
					15 01 00 00 00 00 02 B0 07
					15 01 00 00 00 00 02 B7 12
					39 01 00 00 00 00 03 FC A5 A5
					/* ACL off */
					15 01 00 00 00 00 02 55 00
					39 01 00 00 00 00 03 F0 5A 5A
					15 01 00 00 00 00 02 B0 DD
					15 01 00 00 00 00 02 B9 00
					39 01 00 00 00 00 03 F0 A5 A5
					/*PANEL ON*/
					39 01 00 00 00 00 03 9F A5 A5
					05 01 00 00 00 00 01 29
					39 01 00 00 00 00 03 9F 5A 5A];
				qcom,mdss-dsi-aod-hbm-on-command = [  /*AOD->HBM ON PANEL FINGERPRINT OFF*/
					39 01 00 00 00 00 03 F0 5A 5A
					39 01 00 00 00 00 03 51 03 FF
					15 01 00 00 00 00 02 53 E0
					/* HBM 670 ON */
					39 01 00 00 00 00 03 BD 00 02
					39 01 00 00 00 00 03 F0 A5 A5];
				qcom,mdss-dsi-aod-hbm-off-command = [  /*AOD->HBM OFF PANEL FINGERPRINT OFF*/
					39 01 00 00 00 00 03 F0 5A 5A
					39 01 00 00 00 00 03 BD 00 02
					39 01 00 00 00 00 03 F0 A5 A5
					39 01 00 00 00 00 03 51 00 01
					15 01 00 00 00 00 02 53 22];
				qcom,mdss-dsi-hbm-on-command = [
					39 01 00 00 00 00 03 F0 5A 5A
					15 01 00 00 00 00 02 53 E0
					/* HBM 700 ON */
					39 01 00 00 00 00 03 51 03 FF
					39 01 00 00 00 00 03 BD 00 02
					39 01 00 00 22 00 03 F0 A5 A5];
				qcom,mdss-dsi-hbm-off-command = [
					39 01 00 00 00 00 03 F0 5A 5A
					39 01 00 00 00 00 03 BD 00 02
					39 01 00 00 00 00 03 F0 A5 A5
					15 01 00 00 00 00 02 53 20];
				qcom,mdss-dsi-normal-hbm-on-command = [
					39 01 00 00 00 00 03 F0 5A 5A
					15 01 00 00 00 00 02 53 E8
					/* HBM ON 700nit*/
					39 01 00 00 00 00 03 51 03 FF
					39 01 00 00 00 00 03 BD 00 02
					39 01 00 00 00 00 03 F0 A5 A5];
				qcom,mdss-dsi-normal-652nit-hbm-on-command = [
					39 01 00 00 00 00 03 F0 5A 5A
					15 01 00 00 00 00 02 53 E8
					/* HBM ON 652nit*/
					39 01 00 00 00 00 03 51 01 2A
					39 01 00 00 00 00 03 BD 00 02
					39 01 00 00 00 00 03 F0 A5 A5];
				qcom,mdss-dsi-normal-573nit-hbm-on-command = [
					39 01 00 00 00 00 03 F0 5A 5A
					15 01 00 00 00 00 02 53 E8
					/* HBM ON 573nit*/
					39 01 00 00 00 00 03 51 00 78
					39 01 00 00 00 00 03 BD 00 02
					39 01 00 00 00 00 03 F0 A5 A5];
				qcom,mdss-dsi-aod-high-mode-command = [
					/* AOD 50nit */
					39 01 00 00 00 00 03 F0 5A 5A
					15 01 00 00 00 00 02 53 22
					15 01 00 00 00 00 02 B0 A5
					15 01 00 00 00 00 02 C7 00
					39 01 00 00 00 00 03 F0 A5 A5];
				qcom,mdss-dsi-aod-low-mode-command = [
					/* AOD 10nit */
					39 01 00 00 00 00 03 F0 5A 5A
					15 01 00 00 00 00 02 53 23
					15 01 00 00 00 00 02 B0 A5
					15 01 00 00 00 00 02 C7 00
					39 01 00 00 00 00 03 F0 A5 A5];
				qcom,mdss-dsi-seed-off-command = [
					39 01 00 00 00 00 02 81 00
					39 01 00 00 00 00 03 F0 5A 5A
					39 01 00 00 00 00 03 B1 00 01  /* SEED CRC OFF */
					39 01 00 00 00 00 03 B3 00 C1  /* TCS OFF */
					39 01 00 00 00 00 03 F0 A5 A5];
				qcom,mdss-dsi-seed-srgb-command = [
					39 01 00 00 00 00 02 81 90  /* CRC mode enable */
					39 01 00 00 00 00 03 F0 5A 5A
					39 01 00 00 00 00 02 B0 02
					39 01 00 00 00 00 16 B1 FF 00 00 19 FF 02 0F 08 FF 28 FF E8 FF 08 E4 FF F4 01 FF FF FF  /* CRC LUT */
					39 01 00 00 00 00 03 B1 00 00
					39 01 00 00 00 00 03 F0 A5 A5
					39 01 00 00 00 00 03 F0 5A 5A  /* Seed Tcs On */
					39 01 00 00 00 00 02 B0 23
					39 01 00 00 00 00 02 B3 91
					39 01 00 00 00 00 02 83 80
					39 01 00 00 00 00 03 B3 00 C0
					39 01 00 00 00 00 03 F0 A5 A5];
				qcom,mdss-dsi-seed-dcip3-command = [
					39 01 00 00 00 00 02 81 90  /* CRC mode enable */
					39 01 00 00 00 00 03 F0 5A 5A
					39 01 00 00 00 00 02 B0 02
					39 01 00 00 00 00 16 B1 FF 00 00 19 FF 02 0F 08 FF 28 FF E8 FF 08 E4 FF F4 01 FF FF FF  /* CRC LUT */
					39 01 00 00 00 00 03 B1 00 00
					39 01 00 00 00 00 03 F0 A5 A5
					39 01 00 00 00 00 03 F0 5A 5A  /* Seed Tcs On */
					39 01 00 00 00 00 02 B0 23
					39 01 00 00 00 00 02 B3 91
					39 01 00 00 00 00 02 83 80
					39 01 00 00 00 00 03 B3 00 C0
					39 01 00 00 00 00 03 F0 A5 A5];
				qcom,mdss-dsi-lp1-command-state = "dsi_hs_mode";
				qcom,mdss-dsi-nolp-command-state = "dsi_hs_mode";
				qcom,mdss-dsi-post-on-backlight-state = "dsi_hs_mode";
				qcom,mdss-dsi-on-command-state = "dsi_hs_mode";
				qcom,mdss-dsi-off-command-state = "dsi_hs_mode";
				qcom,mdss-dsi-normal-hbm-on-command-state = "dsi_hs_mode";
				qcom,mdss-dsi-aod-high-mode-command-state = "dsi_hs_mode";
				qcom,mdss-dsi-aod-low-mode-command-state = "dsi_hs_mode";
				qcom,mdss-dsi-normal-652nit-hbm-on-command-state = "dsi_hs_mode";
				qcom,mdss-dsi-normal-573nit-hbm-on-command-state = "dsi_hs_mode";
			};
		};
	};
};
