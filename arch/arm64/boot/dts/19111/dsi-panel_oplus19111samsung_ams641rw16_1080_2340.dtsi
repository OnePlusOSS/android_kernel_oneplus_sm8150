/* Copyright (c) 2014-2018, The Linux Foundation. All rights reserved.
 *
 * This program is free software; you can redistribute it and/or modify
 * it under the terms of the GNU General Public License version 2 and
 * only version 2 as published by the Free Software Foundation.
 *
 * This program is distributed in the hope that it will be useful,
 * but WITHOUT ANY WARRANTY; without even the implied warranty of
 * MERCHANTABILITY or FITNESS FOR A PARTICULAR PURPOSE.  See the
 * GNU General Public License for more details.
 */

&mdss_mdp {
	dsi_oplus19111samsung_ams641rw16_1080_2340_cmd: qcom,mdss_dsi_oplus19111samsung_ams641rw16_1080_2340_cmd {
		qcom,panel-supply-entries = <&dsi_panel_pwr_supply_labibb_amoled>;

		qcom,platform-te-gpio = <&tlmm 10 0>;
		qcom,platform-reset-gpio = <&pm6150l_gpios 9 0>;

		qcom,mdss-dsi-panel-name = "oplus19111samsung ams641rw16 1080 2340 cmd mode dsi panel";
		qcom,mdss-dsi-panel-type = "dsi_cmd_mode";
		qcom,mdss-dsi-virtual-channel-id = <0>;
		qcom,mdss-dsi-stream = <0>;
		qcom,mdss-dsi-bpp = <24>;
		qcom,mdss-dsi-underflow-color = <0xff>;
		qcom,mdss-dsi-border-color = <0>;
		qcom,mdss-dsi-color-order = "rgb_swap_rgb";
		qcom,mdss-dsi-traffic-mode = "non_burst_sync_pulse";
		qcom,mdss-dsi-lane-map = "lane_map_0123";
		qcom,mdss-dsi-bllp-eof-power-mode;
		qcom,mdss-dsi-bllp-power-mode;
		qcom,mdss-dsi-lane-0-state;
		qcom,mdss-dsi-lane-1-state;
		qcom,mdss-dsi-lane-2-state;
		qcom,mdss-dsi-lane-3-state;
		qcom,mdss-pan-physical-width-dimension = <69>;
		qcom,mdss-pan-physical-height-dimension = <148>;
		qcom,mdss-dsi-reset-sequence = <1 5>, <0 5>, <1 10>;
		qcom,mdss-dsi-dma-trigger = "trigger_sw";
		qcom,mdss-dsi-mdp-trigger = "none";
		qcom,mdss-dsi-t-clk-post = <0x0f>;
		qcom,mdss-dsi-t-clk-pre = <0x37>;
		qcom,mdss-dsi-wr-mem-start = <0x2c>;
		qcom,mdss-dsi-wr-mem-continue = <0x3c>;
		qcom,mdss-dsi-te-pin-select = <1>;
		qcom,mdss-dsi-te-dcs-command = <1>;
		qcom,mdss-dsi-te-check-enable;
		qcom,mdss-dsi-te-using-te-pin;
		qcom,mdss-dsi-bl-pmic-control-type = "bl_ctrl_dcs";
		qcom,mdss-dsi-bl-min-level = <1>;
		qcom,mdss-dsi-bl-max-level = <2047>;
		qcom,mdss-brightness-max-level = <2047>;
		qcom,mdss-dsi-panel-jitter = <0x4 0x1>;

		qcom,esd-check-enabled;
		qcom,mdss-dsi-panel-status-read-length = <1>;
		qcom,mdss-dsi-panel-status-check-mode="reg_read";
		qcom,mdss-dsi-panel-status-command = [06 01 00 01 05 00 02 0A 08];
		qcom,mdss-dsi-panel-status-command-state = "dsi_hs_mode";
		qcom,mdss-dsi-panel-status-value = <0x9F>;
		qcom,mdss-dsi-panel-on-check-value = <0x9F>;
		qcom,mdss-dsi-panel-hdr-enabled;
		qcom,mdss-dsi-panel-hdr-color-primaries = <14500 15500 32000
		17000 15500 30000 8000 3000>;
		qcom,mdss-dsi-panel-peak-brightness = <4200000>;
		qcom,mdss-dsi-panel-blackness-level = <3230>;
		qcom,mdss-dsi-display-timings {
			timing@0{
				qcom,mdss-dsi-panel-width = <1080>;
				qcom,mdss-dsi-panel-height = <2340>;
				qcom,mdss-dsi-h-front-porch = <48>;
				qcom,mdss-dsi-h-back-porch = <48>;
				qcom,mdss-dsi-h-pulse-width = <24>;
				qcom,mdss-dsi-h-sync-skew = <0>;
				qcom,mdss-dsi-v-back-porch = <16>;
				qcom,mdss-dsi-v-front-porch = <20>;
				qcom,mdss-dsi-v-pulse-width = <4>;
				qcom,mdss-dsi-panel-framerate = <60>;
				qcom,mdss-dsi-panel-clockrate = <1029000000>;
				qcom,mdss-dsi-panel-phy-timings = [00 22 09 09 25 23 09 09 06 03 04 00];
				qcom,display-topology = <1 0 1>;
				qcom,default-topology-index = <0>;

				qcom,mdss-dsi-on-command = [
					39 01 00 00 00 00 03 9F A5 A5
					05 01 00 00 05 00 01 11
					39 01 00 00 00 00 03 9F 5A 5A
					/* FD setting */
					39 01 00 00 00 00 03 F0 5A 5A
					15 01 00 00 00 00 02 B0 01
					15 01 00 00 00 00 02 CD 01
					39 01 00 00 00 00 03 F0 A5 A5
					/* Power Sequence Setting */
					39 01 00 00 00 00 03 F0 5A 5A
					15 01 00 00 00 00 02 B0 70
					15 01 00 00 00 00 02 B9 D7
					15 01 00 00 00 00 02 B0 07
					39 01 00 00 00 00 05 EF 45 11 31 11
					15 01 00 00 00 00 02 B0 6E
					15 01 00 00 00 00 02 B9 81
					15 01 00 00 00 00 02 B0 09
					15 01 00 00 00 00 02 EF 31
					39 01 00 00 14 00 03 F0 A5 A5
					/* TE vsync ON */
					39 01 00 00 00 00 03 9F A5 A5
					15 01 00 00 00 00 02 35 00
					39 01 00 00 00 00 03 9F 5A 5A
					/* MIC Setting */
					39 01 00 00 00 00 03 F0 5A 5A
					39 01 00 00 00 00 08 EB 17 41 92 0E 10 82 5A
					39 01 00 00 00 00 03 F0 A5 A5
					/* CASET/PASET Setting */
					39 01 00 00 00 00 05 2A 00 00 04 37
					39 01 00 00 00 00 05 2B 00 00 09 23
					/* TSP H_sync Setting*/
					/* 39 01 00 00 00 00 03 F0 5A 5A */
					/* 15 01 00 00 00 00 02 B0 09 */
					/* 15 01 00 00 00 00 03 E8 10 30 */
					/* 39 01 00 00 00 00 03 F0 A5 A5 */
					/* ESD Setting */
					39 01 00 00 00 00 03 FC 5A 5A
					15 01 00 00 00 00 02 B0 01
					15 01 00 00 00 00 02 E3 88
					15 01 00 00 00 00 02 B0 07
					15 01 00 00 00 00 02 ED 67
					39 01 00 00 3C 00 03 FC A5 A5
					/* Backlight Dimming Setting */
					39 01 00 00 00 00 03 F0 5A 5A
					15 01 00 00 00 00 02 B0 07
					15 01 00 00 00 00 02 B7 01
					15 01 00 00 00 00 02 B0 08
					15 01 00 00 00 00 02 B7 12
					39 01 00 00 00 00 03 F0 A5 A5
					15 01 00 00 00 00 02 53 28
					/* ACL off */
					15 01 00 00 00 00 02 55 00
					/* CRC mode enable */
					39 01 00 00 00 00 02 81 90
					39 01 00 00 00 00 03 F0 5A 5A
					39 01 00 00 00 00 02 B0 02
					39 01 00 00 00 00 16 B1 E0 00 08 10 FF 00 00 00 FF 15 FD F0 F0 00 F0 EC F0 00 FF FF FF  /* CRC LUT */
					39 01 00 00 00 00 03 B1 00 00
					39 01 00 00 00 00 03 F0 A5 A5
					/* Seed Tcs On */
					39 01 00 00 00 00 03 F0 5A 5A
					39 01 00 00 00 00 02 B0 23
					39 01 00 00 00 00 02 B3 91
					39 01 00 00 00 00 02 83 80
					39 01 00 00 00 00 03 B3 00 C0
					39 01 00 00 00 00 03 F0 A5 A5];
				qcom,mdss-dsi-post-on-backlight = [
					39 01 00 00 00 00 03 9F A5 A5
					05 01 00 00 00 00 01 29
					39 01 00 00 00 00 03 9F 5A 5A];
				qcom,mdss-dsi-off-command = [
					39 01 00 00 00 00 03 9F A5 A5
					05 01 00 00 0A 00 01 28
					05 01 00 00 00 00 01 10
					39 01 00 00 00 00 03 9F 5A 5A
					39 01 00 00 00 00 03 F0 5A 5A
					15 01 00 00 00 00 02 B0 05
					15 01 00 00 00 00 02 F4 01
					15 01 00 00 00 00 02 B0 01
					15 01 00 00 00 00 02 CD 02
					39 01 00 00 96 00 03 F0 A5 A5];
				qcom,mdss-dsi-lp1-command = [
					/* AOD ON */
					/* display off & sleep in */
					39 01 00 00 00 00 03 9F A5 A5
					05 01 00 00 0A 00 01 28
					05 01 00 00 00 00 01 10
					39 01 00 00 00 00 03 9F 5A 5A
					/* VCI stabilizationg setting */
					39 01 00 00 00 00 03 F0 5A 5A
					15 01 00 00 00 00 02 B0 05
					15 01 00 00 00 00 02 F4 01
					39 01 00 00 78 00 03 F0 A5 A5
					/* sleep out */
					39 01 00 00 00 00 03 9F A5 A5
					05 01 00 00 05 00 01 11
					39 01 00 00 00 00 03 9F 5A 5A
					/* AOD ON */
					39 01 00 00 00 00 03 F0 5A 5A
					15 01 00 00 00 00 02 53 23
					15 01 00 00 00 00 02 B0 A5
					15 01 00 00 73 00 02 C7 00
					39 01 00 00 00 00 03 F0 A5 A5
					/* Seed CRC mode enable */
					15 01 00 00 00 00 02 81 90
					39 01 00 00 00 00 03 F0 5A 5A
					15 01 00 00 00 00 02 B0 02
					39 01 00 00 00 00 16 B1 E0 00 08 1C F8 00 04 0F FF 24 FD DC FD 00 F6 F1 F0 00 FF FF FF  /* CRC LUT */
					39 01 00 00 00 00 03 B1 00 00
					39 01 00 00 00 00 03 F0 A5 A5
					/* Seed Tcs On */
					39 01 00 00 00 00 03 F0 5A 5A
					15 01 00 00 00 00 02 B0 23
					15 01 00 00 00 00 02 B3 91
					15 01 00 00 00 00 02 83 80
					39 01 00 00 00 00 03 B3 00 C0
					39 01 00 00 00 00 03 F0 A5 A5
                                        ];
				qcom,mdss-dsi-nolp-command = [    /* AOD OFF */
					/*AOD OFF*/
					39 01 00 00 00 00 02 53 28
					/* TE vsync ON */
					39 01 00 00 00 00 03 9F A5 A5
					15 01 00 00 00 00 02 35 00
					39 01 00 00 00 00 03 9F 5A 5A
					/* FD setting */
					39 01 00 00 00 00 03 F0 5A 5A
					15 01 00 00 00 00 02 B0 01
					15 01 00 00 00 00 02 CD 01
					39 01 00 00 00 00 03 F0 A5 A5
					/* MIC Setting */
					39 01 00 00 00 00 03 F0 5A 5A
					39 01 00 00 00 00 08 EB 17 41 92 0E 10 82 5A
					39 01 00 00 00 00 03 F0 A5 A5
					/* CASET/PASET Setting */
					39 01 00 00 00 00 05 2A 00 00 04 37
					39 01 00 00 00 00 05 2B 00 00 09 23
					/* ESD Setting */
					39 01 00 00 00 00 03 FC 5A 5A
					15 01 00 00 00 00 02 B0 01
					15 01 00 00 00 00 02 E3 88
					15 01 00 00 00 00 02 B0 07
					15 01 00 00 00 00 02 ED 67
					39 01 00 00 00 00 03 FC A5 A5
					/* Backlight Dimming Setting */
					39 01 00 00 00 00 03 F0 5A 5A
					15 01 00 00 00 00 02 B0 08
					15 01 00 00 00 00 02 B7 12
					39 01 00 00 00 00 03 BD 00 02
					39 01 00 00 00 00 03 F0 A5 A5
					/*AOD OFF*/
					15 01 00 00 00 00 02 53 20
					/* ACL off */
					15 01 00 00 00 00 02 55 00
					39 01 00 00 00 00 03 F0 5A 5A
					15 01 00 00 00 00 02 B0 DE
					15 01 00 00 00 00 02 B9 00
					39 01 00 00 00 00 03 F0 A5 A5
					/*PANEL ON*/
					39 01 00 00 00 00 03 9F A5 A5
					05 01 00 00 00 00 01 13
					05 01 00 00 00 00 01 29
					39 01 00 00 00 00 03 9F 5A 5A
                                        ];
				qcom,mdss-dsi-aod-hbm-on-command = [  /*AOD->HBM ON PANEL FINGERPRINT OFF*/
					/* HBM 600 nit */
					39 01 00 00 00 00 03 9F A5 A5
					39 01 00 00 00 00 03 51 03 FF
					15 01 00 00 00 00 02 53 E0
					39 01 00 00 00 00 03 9F 5A 5A
					/* HBM 670 ON */
					39 01 00 00 00 00 03 F0 5A 5A
					39 01 00 00 00 00 03 BD 00 00
					39 01 00 00 00 00 03 F0 A5 A5
                                        ];
				qcom,mdss-dsi-aod-hbm-off-command = [  /*AOD->HBM OFF PANEL FINGERPRINT OFF*/
					39 01 00 00 00 00 03 F0 5A 5A
					39 01 00 00 00 00 03 BD 00 02
					39 01 00 00 00 00 03 F0 A5 A5
					39 01 00 00 00 00 03 51 00 01
					15 01 00 00 00 00 02 53 22
                                        ];
				qcom,mdss-dsi-hbm-on-command = [
					/* HBM 600 nit */
					39 01 00 00 00 00 03 9F A5 A5
					39 01 00 00 00 00 03 51 03 FF
					15 01 00 00 00 00 02 53 E0
					39 01 00 00 00 00 03 9F 5A 5A
					/* HBM 670 ON */
					39 01 00 00 00 00 03 F0 5A 5A
					39 01 00 00 00 00 03 BD 00 00
					39 01 00 00 22 00 03 F0 A5 A5
                                        ];
				qcom,mdss-dsi-hbm-off-command = [
					39 01 00 00 00 00 03 F0 5A 5A
					39 01 00 00 00 00 03 BD 00 02
					39 01 00 00 00 00 03 F0 A5 A5
					15 01 00 00 00 00 02 53 20
                                        ];
				qcom,mdss-dsi-normal-hbm-on-command = [
					/* HBM 600 nit */
					39 01 00 00 00 00 03 9F A5 A5
					39 01 00 00 00 00 03 51 03 FF
					15 01 00 00 00 00 02 53 E0
					39 01 00 00 00 00 03 9F 5A 5A
					/* HBM ON 600nit*/
					39 01 00 00 00 00 03 F0 5A 5A
					39 01 00 00 00 00 03 BD 00 02
					39 01 00 00 00 00 03 F0 A5 A5
                                        ];
				qcom,mdss-dsi-aod-high-mode-command = [
					/* AOD 50nit */
					39 01 00 00 00 00 03 F0 5A 5A
					15 01 00 00 00 00 02 53 22
					15 01 00 00 00 00 02 B0 A5
					15 01 00 00 00 00 02 C7 00
					39 01 00 00 00 00 03 F0 A5 A5
                                        ];
				qcom,mdss-dsi-aod-low-mode-command = [
					/* AOD 10nit */
					39 01 00 00 00 00 03 F0 5A 5A
					15 01 00 00 00 00 02 53 23
					15 01 00 00 00 00 02 B0 A5
					15 01 00 00 00 00 02 C7 00
					39 01 00 00 00 00 03 F0 A5 A5
                                        ];
				qcom,mdss-dsi-seed-off-command = [
					39 01 00 00 00 00 02 81 00
					39 01 00 00 00 00 03 F0 5A 5A
					39 01 00 00 00 00 03 B1 00 01  /* SEED CRC OFF */
					39 01 00 00 00 00 03 B3 00 C1  /* TCS OFF */
					39 01 00 00 00 00 03 F0 A5 A5];
				qcom,mdss-dsi-seed-0-command = [
					39 01 00 00 00 00 02 81 90  /* CRC mode enable */
					39 01 00 00 00 00 03 F0 5A 5A
					39 01 00 00 00 00 02 B0 02
					39 01 00 00 00 00 16 B1 E0 00 08 10 FF 00 00 00 FF 15 FD F0 F0 00 F0 EC F0 00 FF FF FF  /* CRC LUT */
					39 01 00 00 00 00 03 B1 00 00
					39 01 00 00 00 00 03 F0 A5 A5
					39 01 00 00 00 00 03 F0 5A 5A  /* Seed Tcs On */
					39 01 00 00 00 00 02 B0 23
					39 01 00 00 00 00 02 B3 91
					39 01 00 00 00 00 02 83 80
					39 01 00 00 00 00 03 B3 00 C0
					39 01 00 00 00 00 03 F0 A5 A5];
				qcom,mdss-dsi-seed-1-command = [
					39 01 00 00 00 00 02 81 90  /* CRC mode enable */
					39 01 00 00 00 00 03 F0 5A 5A
					39 01 00 00 00 00 02 B0 02
					39 01 00 00 00 00 16 B1 B0 04 05 4C DC 15 05 0D D0 56 ED D0 CC 12 D0 F1 EA 1D FF FF FF  /* CRC LUT */
					39 01 00 00 00 00 03 B1 00 00
					39 01 00 00 00 00 03 F0 A5 A5
					39 01 00 00 00 00 03 F0 5A 5A  /* Seed Tcs On */
					39 01 00 00 00 00 02 B0 23
					39 01 00 00 00 00 02 B3 91
					39 01 00 00 00 00 02 83 80
					39 01 00 00 00 00 03 B3 00 C0
					39 01 00 00 00 00 03 F0 A5 A5];
				qcom,mdss-dsi-lp1-command-state = "dsi_hs_mode";
				qcom,mdss-dsi-nolp-command-state = "dsi_hs_mode";
				qcom,mdss-dsi-post-on-backlight-state = "dsi_hs_mode";
				qcom,mdss-dsi-on-command-state = "dsi_hs_mode";
				qcom,mdss-dsi-off-command-state = "dsi_hs_mode";
			};
		};
	};
};
