## Documentation/devicetree/bindings/input/tri_state_key.txt
```
Tri-state key

Required Properties:
- compatible:			Must be "ompatible = "oneplus,tri-state-key".


Example:

		tri_state_key {
		compatible = "oneplus, tri-state-key";
		status = "okay";
		interrupt-parent = <&tlmm>;
		tristate,gpio_key1 = <&tlmm 125 0x00>;
		tristate,gpio_key2 = <&tlmm 134 0x00>;
		tristate,gpio_key3 = <&tlmm 27 0x00>;
		pinctrl-names =
				"pmx_tri_state_key_active",
				"pmx_tri_state_key_suspend";
		pinctrl-0 = <&tri_state_key_active>;
		pinctrl-1 = <&tri_state_key_suspend>;
	};
```

## Kconfig
```kconfig
# SPDX-License-Identifier: GPL-2.0
#
# For a description of the syntax of this configuration file,
# see Documentation/kbuild/kconfig-language.txt.
#
mainmenu "Linux/$ARCH $KERNELVERSION Kernel Configuration"

#ifdef CONFIG_OPLUS_SYSTEM_KERNEL
config OPLUS_SYSTEM_KERNEL_QCOM
  bool "config oplus system feature "
  default y
  help
	define this config to Distinguish between qcom and mtk platform

config OPLUS_FEATURE_PANIC_FLUSH
	bool "fsync optimization "
	default y
	help
		define this config to fsync optimization

#endif /*CONFIG_OPLUS_SYSTEM_KERNEL*/



config SRCARCH
	string
	option env="SRCARCH"

source "arch/$SRCARCH/Kconfig"
```

## coretech/Kconfig
```kconfig
config OPCHAIN
	default n
	bool "Oneplus CoreTech helper, used for opchain module"
config MEMPLUS
	default n
	bool "memory+ feature"
	help
	 Memory+ feature
config SMART_BOOST
	bool "support smart boost feature"
	default n
	help
	 this feature allow memory used by recent-app stay in kernel.
config DEFRAG
	default n
	bool "anti-defragment feature"
	help
	 anti-defragment feature.
config FSC
	default n
	bool "system layer file status cache"
	help
	 To cache absence file and avoid stat call storm
config HOUSTON
	default n
	bool "to collect system-wide and pmu data"
	help
	 Realtime temperature monitor
config CONTROL_CENTER
	default n
	bool "control center"
	help
	 A framework to adjust system resource such as perfd, but easy to extend
	 the scope of use. Support priority control between different request and
	 QoS for keep adjusting for a specific period. Besides resource controlling,
	 it also provide a decision model for helping governor to make decision.
config AIGOV
	default n
	bool "A governor which using ai predicted info as input"
config IM
	bool "identify task itself"
	default n
	help
	  In many cases we need to identify task, all we do is simply string compare,
	  but in some performance sensitive context like scheduler, it's not a good choice to
	  do that. So this IM thing can let we check task only through one comparsion.
config UXCHAIN
	default n
	bool "A sched policy for ux relative threads"
config PCCORE
	default n
	bool "pccore feature"
config TPD
	default n
	bool "a task placement decision for cpu limitation"
	help
	  task affinity by decison
```

## drivers/firmware/qcom/Kconfig
```kconfig
config MSM_TZ_LOG
        tristate "MSM Trust Zone (TZ) Log Driver"
        #ifdef OPLUS_FEATURE_SECURITY_COMMON
        #depends on DEBUG_FS
        #endif
        help
          This option enables a driver with a debugfs interface for messages
          produced by the Secure code (Trust zone). These messages provide
          diagnostic information about TZ operation.
```

## drivers/infrared_proximity/Kconfig
```kconfig
config INFRARED_PROXIMITY
	bool "Oneplus infrared proximity power control"
	help
	 Add support for oneplus infrared proximity power control.
	 This driver is used to control the infrared proximity
	 led power.
```

## drivers/input/touchscreen/oneplus_touchscreen/Focal/FT8006/Kconfig
```kconfig
#Added by Cong.Dai@Bsp.group.Tp for focal ft8006 ic driver

config TOUCHPANEL_FOCAL_FT8006
#	default y
	bool "TP focal_ft8006 IC enable or not for OPPO"
	---help---
	say Y to enable driver for Touchpanel useing focal ft8006
```

## drivers/input/touchscreen/oneplus_touchscreen/Goodix/GT9286/Kconfig
```kconfig
#Added by Cong.Dai@Bsp.group.Tp for focal gt9286 ic driver

config TOUCHPANEL_GOODIX_GT9286
#   default y
    bool "TP goodix gt9286 IC enable or not for OPPO"
    ---help---
    say Y to enable driver for Touchpanel useing goodix gt9286
```

## drivers/input/touchscreen/oneplus_touchscreen/Goodix/Goodix_gt5688/Kconfig
```kconfig
config TOUCHPANEL_GOODIX_GT5688
#	default y
	bool "TP TOUCHPANEL_GOODIX_GT5688 IC enable or not"
	---help---
	say Y to enable driver for Touchpanel useing TOUCHPANEL_GOODIX_GT5688
	
```

## drivers/input/touchscreen/oneplus_touchscreen/Goodix/Kconfig
```kconfig
source "drivers/input/touchscreen/oneplus_touchscreen/Goodix/Goodix_gt5688/Kconfig"
source "drivers/input/touchscreen/oneplus_touchscreen/Goodix/GT9286/Kconfig"
```

## drivers/input/touchscreen/oneplus_touchscreen/Himax/hx83112b/Kconfig
```kconfig
#Added by MingQiang.Guo@Bsp.group.Tp for himax hx833112B ic driver

config TOUCHPANEL_HIMAX_HX83112B
#	default y
	bool "TP himax hx83112b IC enable or not for OPPO"
	---help---
	say Y to enable driver for Touchpanel useing himax hx83112b
```

## drivers/input/touchscreen/oneplus_touchscreen/Kconfig
```kconfig
config TOUCHPANEL_MTK_PLATFORM
	bool "OPPO platform tp module used"
	help
	  Say Y here if you have mtk-platform.

config TOUCHPANEL_ONEPLUS
	bool "ONEPLUS tp module"
	help
	  Say Y here if you have touchscreen module.

config TOUCHPANEL_SYNAPTICS
#	default y
	bool "TP Synaptics_IC enable or not for OPPO"
	---help---
	say Y to enable driver for Touchpanel using Synaptics_IC

config TOUCHPANEL_FOCAL
#	default y
	bool "TP Synaptics_IC enable or not for OPPO"
	---help---
	say Y to enable driver for Touchpanel using FOCALTECK_IC

config TOUCHPANEL_GOODIX
#	default y
	bool "TP Synaptics_IC enable or not for OPPO"
	---help---
	say Y to enable driver for Touchpanel using GOODIX_IC

config TOUCHPANEL_NOVA
#	default y
	bool "TP Nova_IC enable or not for OPPO"
	---help---
	say Y to enable driver for Touchpanel using NOVATECK_IC
config TOUCHPANEL_HIMAX
#	default y
	bool "TP HIMAX_IC enable or not for OPPO"
	---help---
	say Y to enable driver for Touchpanel using HIMAX_IC

config TOUCHPANEL_SAMSUNG
#	default y
	bool "TP samsung IC enable or not for OPPO"
	---help---
	say Y to enable driver for Touchpanel using samsung IC

config TOUCHPANEL_ST
#	default y
	bool "TP st IC enable or not for OPPO"
	---help---
	say Y to enable driver for Touchpanel using st IC

source "drivers/input/touchscreen/oneplus_touchscreen/util_interface/Kconfig"

if TOUCHPANEL_SYNAPTICS
source "drivers/input/touchscreen/oneplus_touchscreen/Synaptics/Kconfig"
endif

if TOUCHPANEL_GOODIX
source "drivers/input/touchscreen/oneplus_touchscreen/Goodix/Kconfig"
endif

if TOUCHPANEL_FOCAL
source "drivers/input/touchscreen/oneplus_touchscreen/Focal/Kconfig"
endif

if TOUCHPANEL_NOVA
source "drivers/input/touchscreen/oneplus_touchscreen/Novatek/Kconfig"
endif

if TOUCHPANEL_HIMAX
source "drivers/input/touchscreen/oneplus_touchscreen/Himax/Kconfig"
endif

if TOUCHPANEL_SAMSUNG
source "drivers/input/touchscreen/oneplus_touchscreen/Samsung/Kconfig"
endif

if TOUCHPANEL_ST
source "drivers/input/touchscreen/oneplus_touchscreen/St/Kconfig"
endif
```

## drivers/input/touchscreen/oneplus_touchscreen/Novatek/Kconfig
```kconfig
source "drivers/input/touchscreen/oneplus_touchscreen/Novatek/NT36672/Kconfig"
source "drivers/input/touchscreen/oneplus_touchscreen/Novatek/NT36525/Kconfig"
source "drivers/input/touchscreen/oneplus_touchscreen/Novatek/NT36672_noflash/Kconfig"
```

## drivers/input/touchscreen/oneplus_touchscreen/Novatek/NT36525/Kconfig
```kconfig
#Added by Cong.Dai@Bsp.group.Tp for nova nt36525 ic driver

config TOUCHPANEL_NOVA_NT36525
#	default y
	bool "TP nova nt36525 IC enable or not for OPPO"
	---help---
	say Y to enable driver for Touchpanel useing nova nt36525
```

## drivers/input/touchscreen/oneplus_touchscreen/Novatek/NT36672_noflash/Kconfig
```kconfig
#Added by Cong.Dai@Bsp.group.Tp for nova nt36672 ic driver

config TOUCHPANEL_NOVA_NT36672
#	default y
	bool "TP nova nt36672 IC enable or not for OPPO"
	---help---
	say Y to enable driver for Touchpanel useing nova nt36672


config TOUCHPANEL_NOVA_NT36672_NOFLASH
#	default y
	bool "TP nova nt36672 IC enable or not for OPPO"
	---help---
	say Y to enable driver for Touchpanel useing nova nt36672

#endif
```

## drivers/input/touchscreen/oneplus_touchscreen/St/fst1ba90a/Kconfig
```kconfig
#Added by Zengpeng.Chen@Bsp.group.Tp for ST ic driver

config TOUCHPANEL_ST_FST1BA90A
#	default y
	bool "TP ST_FST1BA90A IC enable or not for OPPO"
	---help---
	  say Y to enable driver for Touchpanel using ST FST1BA90A IC
```

## drivers/misc/oplus_motor/Kconfig
```kconfig
menuconfig OPLUS_MOTOR
	bool "OPLUS motor control system"
	depends on I2C
	select REGMAP_I2C
	help
	  Say Y here to enable OPLUS motor control system support

if OPLUS_MOTOR

config CAMERA_MOTOR_DRV8834
	tristate "CAMERA MOTOR DRV8834 Controler"
	default n
	help
	  Say Y here to enable DRV8834.

config DIGITAL_HALL_M1120
	tristate "digital hall m1120 Controler"
	default n
	help
	  Say Y here to enable m1120.

config MOTOR_DETECT_QOS
	bool "OPLUS motor detect position update qos"
	help
	  Say Y here if you want to update qos value in position detect.

config MOTOR_CLASS_INTERFACE
	bool "OPLUS motor class interface"
	help
	  Say Y here if you want to using motor class interface

endif #OPLUS_CHARGER
```

## drivers/misc/tri_state_key/Kconfig
```kconfig
config OPLUS_TRIKEY_HALL
	tristate "hall ic support"
	default n
	help
	  Say Y here if you want to enable the feature.

config OPLUS_TRIKEY_MAIN
	tristate "tri state key support"
	default n
	help
	  Say Y here if you want to enable the feature.

config OPLUS_TRI_STATE_KEY
	tristate "oplus mechanical tri state key support"
	default n
	help
	  Say Y here if you want to enable the feature.

source "drivers/misc/tri_state_key/ist_hall_ic/Kconfig"
source "drivers/misc/tri_state_key/hall_ic/Kconfig"
```

## drivers/misc/tri_state_key/hall_ic/Kconfig
```kconfig
config MXM_UP
	tristate "hall up ic support"
	default n
	help
	  Say Y here to enable mxm1120 up.

config MXM_DOWN
	tristate "hall down ic support"
	default n
	help
	  Say Y here to enable mxm1120 down.
```

## drivers/misc/tri_state_key/ist_hall_ic/Kconfig
```kconfig
config IST_UP
	tristate "hall up ic support"
	default n
	help
	  Say Y here to enable ist8801 up.

config IST_DOWN
	tristate "hall down ic support"
	default n
	help
	  Say Y here to enable ist8801 down.
```

## drivers/nfc/oplus_nfc/Kconfig
```kconfig
config OPLUS_NFC
  bool "config oplus nfc chipset"
  default y
  help
	define this config to get chipset version from dts.
```
